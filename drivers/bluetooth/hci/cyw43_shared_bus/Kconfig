## drivers/timer/Kconfig.rpi_pico
```kconfig
# Copyright (c) 2026 TaiJu Wu
# SPDX-License-Identifier: Apache-2.0

config RPI_PICO_SYSTEM_TIMER
	bool "Raspberry Pi RP2350 TIMER system timer"
	default y if SMP && ARM
	depends on SOC_SERIES_RP2350
	depends on $(dt_nodelabel_enabled,timer0)
	select TICKLESS_CAPABLE
	select TIMER_HAS_64BIT_CYCLE_COUNTER
	help
	  System timer on the RP2350 TIMER peripheral: a 64-bit 1 MHz counter
	  shared by both cores. Unlike the per-core SysTick, it works on SMP.
```

## dts/bindings/bluetooth/infineon,cyw43-bt-hci.yaml
```yaml
# Copyright (c) 2026
# SPDX-License-Identifier: Apache-2.0

description: |
  Bluetooth HCI for the Bluetooth controller inside the Infineon CYW43439
  Wi-Fi/BT combo (e.g. Raspberry Pi Pico 2 W). The BT controller shares the
  gSPI bus with the Wi-Fi side ("BT over shared bus"); this node represents
  the HCI transport over that shared bus.

compatible: "infineon,cyw43-bt-hci"

include: bt-hci.yaml
```

## tests/kernel/msgq/msgq_api/testcase.yaml
```yaml
tests:
  kernel.message_queue:
    tags:
      - kernel
      - userspace
  kernel.message_queue.put_front:
    tags:
      - kernel
      - userspace
    extra_configs:
      - CONFIG_TEST_MSGQ_PUT_FRONT=y
```

## tests/ztest/inject/testcase.yaml
```yaml
common:
  tags:
    - test_framework
    - kernel
    - smp
  integration_platforms:
    - qemu_x86_64
tests:
  testing.ztest.inject: {}
  testing.ztest.inject.timeout_wheel:
    extra_configs:
      - CONFIG_TIMEOUT_BACKEND_WHEEL=y
```
