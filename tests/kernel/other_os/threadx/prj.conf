## CMakeLists.txt
```
# SPDX-License-Identifier: Apache-2.0

cmake_minimum_required(VERSION 3.20.0)
find_package(Zephyr REQUIRED HINTS $ENV{ZEPHYR_BASE})
project(threadx_port)

target_sources(app PRIVATE src/main.c src/terminate.c src/isr_suspend.c
			    src/event_suspend.c)
target_include_directories(app PRIVATE ${ZEPHYR_BASE}/kernel/include
			   ${ZEPHYR_BASE}/arch/${ARCH}/include)
```

## prj.conf
```kconfig
CONFIG_ZTEST=y
CONFIG_ZTEST_STACK_SIZE=2048
CONFIG_NUM_PREEMPT_PRIORITIES=32
CONFIG_EVENTS=y
CONFIG_ASSERT=y
CONFIG_SPIN_VALIDATE=y
```

## src/main.c
```c
/*
 * SPDX-License-Identifier: Apache-2.0
 */

#include "tx_port.h"

struct k_thread tx_thread[TX_THREADS];
static K_THREAD_STACK_ARRAY_DEFINE(tx_stack, TX_THREADS, TX_STACK_SIZE);
volatile int tx_error;

void tx_run_main(const struct tx_thread_def *defs, int n, int main_idx)
{
	__ASSERT_NO_MSG(n <= TX_THREADS);
	tx_error = 0;

	for (int i = 0; i < n; i++) {
		k_thread_create(&tx_thread[i], tx_stack[i], TX_STACK_SIZE,
				defs[i].entry, NULL, NULL, NULL, defs[i].prio, 0,
				K_FOREVER);
	}

	/* Like the end of tx_application_define(): every auto-start thread
	 * becomes ready at once, in creation order.
	 */
	k_sched_lock();
	for (int i = 0; i < n; i++) {
		if (defs[i].auto_start) {
			k_thread_start(&tx_thread[i]);
		}
	}
	k_sched_unlock();

	int ret = k_thread_join(&tx_thread[main_idx], K_SECONDS(30));

	for (int i = 0; i < n; i++) {
		k_thread_abort(&tx_thread[i]);
	}

	zassert_equal(ret, 0, "thread 0 did not finish");
	zassert_equal(tx_error, 0, "ThreadX ERROR #%d", tx_error);
}

void tx_run(const struct tx_thread_def *defs, int n)
{
	tx_run_main(defs, n, 0);
}

ZTEST_SUITE(threadx_port, NULL, NULL, ztest_simple_1cpu_before,
	    ztest_simple_1cpu_after, NULL);
```

## src/event_suspend.c
```c
/*
 * SPDX-License-Identifier: Apache-2.0
 *
 * Ports of the ThreadX event flag suspension tests
 * (test/tx/regression/threadx_event_flag_suspension*_test.c): several
 * threads blocked on one group, woken by a single set.
 *
 * ThreadX -> Zephyr:
 * - tx_event_flags_set(TX_OR)            k_event_post()
 * - tx_event_flags_set(v, TX_AND)        k_event_clear(~v)
 * - tx_event_flags_get(TX_AND)           k_event_wait_all()
 * - tx_event_flags_get(TX_AND_CLEAR)     k_event_wait_all_safe()
 * - tx_event_flags_get(TX_OR_CLEAR)      k_event_wait_safe()
 * - TX_NO_EVENTS                         0 returned
 * tx_event_flags_get() returns the whole group in actual_events, Zephyr
 * returns the requested bits that matched, so a check of actual_events
 * against v becomes a check against (v & requested). The set notify
 * callback has no Zephyr counterpart and is left out. See README.rst.
 */

#include "tx_port.h"

static struct k_event group_0;
static volatile unsigned long thread_0_counter;
static volatile unsigned long thread_1_counter;
static volatile unsigned long thread_2_counter;
static volatile unsigned long thread_3_counter;
static volatile unsigned long thread_4_counter;

static void counters_reset(void)
{
	k_event_init(&group_0);
	thread_0_counter = 0;
	thread_1_counter = 0;
	thread_2_counter = 0;
	thread_3_counter = 0;
	thread_4_counter = 0;
}

/* threadx_event_flag_suspension_test.c */

static void susp_thread_0(void *p1, void *p2, void *p3)
{
	uint32_t event_flag = 1;

	for (int i = 0; i < 32; i++) {
		thread_0_counter++;
		k_event_post(&group_0, event_flag);

		if ((i < 31) && ((thread_1_counter != 1) || (thread_2_counter != 1) ||
				 (thread_3_counter != 1))) {
			TX_ERROR(10);
		}
		if ((i == 31) && ((thread_1_counter != 2) || (thread_2_counter != 2) ||
				  (thread_3_counter != 2))) {
			TX_ERROR(11);
		}
		event_flag <<= 1;
		if (event_flag == 0) {
			event_flag = 1;
		}
	}

	k_event_clear(&group_0, ~0U);
	k_thread_start(&tx_thread[4]);
	if (thread_4_counter != 1) {
		TX_ERROR(11);
	}

	k_event_post(&group_0, 0x1);
	if (thread_4_counter != 2) {
		TX_ERROR(12);
	}
}

static void susp_thread_1(void *p1, void *p2, void *p3)
{
	while (1) {
		thread_1_counter++;
		if (k_event_wait_all(&group_0, 0x80008000, false, K_FOREVER) != 0x80008000) {
			return;
		}
		k_event_clear(&group_0, ~0U);
	}
}

static void susp_thread_2(void *p1, void *p2, void *p3)
{
	volatile unsigned long *counter = p1;

	while (1) {
		(*counter)++;
		if (k_event_wait_all(&group_0, 0x80008000, false, K_FOREVER) != 0x80008000) {
			return;
		}
	}
}

static void susp_thread_4(void *p1, void *p2, void *p3)
{
	while (1) {
		thread_4_counter++;
		if (k_event_wait_safe(&group_0, 0x1, false, K_FOREVER) != 0x1) {
			return;
		}
	}
}

ZTEST(threadx_port, test_event_flag_suspension)
{
	const struct tx_thread_def defs[] = {
		{ susp_thread_0, 17, true },
		{ susp_thread_1, 16, true },
		{ susp_thread_2, 16, true, (void *)&thread_2_counter },
		{ susp_thread_2, 16, true, (void *)&thread_3_counter },
		{ susp_thread_4, 16, false },
	};

	counters_reset();
	tx_run(defs, ARRAY_SIZE(defs));
}

/* threadx_event_flag_suspension_consume_test.c: thread 1 consumes the bits
 * it waited for; threads 2 and 3, woken by the same set, still see them.
 */

static void consume_thread_0(void *p1, void *p2, void *p3)
{
	uint32_t event_flag = 1;

	for (int i = 0; i < 32; i++) {
		thread_0_counter++;
		k_event_post(&group_0, event_flag);

		if ((i < 31) && ((thread_1_counter != 1) || (thread_2_counter != 1) ||
				 (thread_3_counter != 1))) {
			TX_ERROR(9);
		}
		if ((i == 31) && ((thread_1_counter != 2) || (thread_2_counter != 2) ||
				  (thread_3_counter != 2))) {
			TX_ERROR(10);
		}
		event_flag <<= 1;
		if (event_flag == 0) {
			event_flag = 1;
		}
	}
}

static void consume_thread_1(void *p1, void *p2, void *p3)
{
	while (1) {
		thread_1_counter++;
		if (k_event_wait_all_safe(&group_0, 0x80008000, false, K_FOREVER) !=
		    0x80008000) {
			return;
		}
	}
}

ZTEST(threadx_port, test_event_flag_suspension_consume)
{
	const struct tx_thread_def defs[] = {
		{ consume_thread_0, 17, true },
		{ consume_thread_1, 16, true },
		{ susp_thread_2, 16, true, (void *)&thread_2_counter },
		{ susp_thread_2, 16, true, (void *)&thread_3_counter },
	};

	counters_reset();
	tx_run(defs, ARRAY_SIZE(defs));
}

/* threadx_event_flag_suspension_different_bits_test.c and
 * threadx_event_flag_suspension_different_bits_consume_test.c: two threads
 * waiting for different bits; a set wakes only the matching one.
 */

static void bits_thread_0(void *p1, void *p2, void *p3)
{
	thread_0_counter++;
	k_event_post(&group_0, 0x80000000);
	if ((thread_1_counter != 2) || (thread_2_counter != 1)) {
		TX_ERROR(7);
	}

	k_event_post(&group_0, 0x00008000);
	if ((thread_1_counter != 2) || (thread_2_counter != 2)) {
		TX_ERROR(8);
	}
}

static void bits_thread_1(void *p1, void *p2, void *p3)
{
	bool consume = POINTER_TO_INT(p1);

	while (1) {
		thread_1_counter++;
		if (consume) {
			if (k_event_wait_all_safe(&group_0, 0x80000000, false, K_FOREVER) !=
			    0x80000000) {
				return;
			}
		} else {
			if (k_event_wait_all(&group_0, 0x80000000, false, K_FOREVER) !=
			    0x80000000) {
				return;
			}
			k_event_clear(&group_0, ~0x7FFFFFFFU);
		}
	}
}

static void bits_thread_2(void *p1, void *p2, void *p3)
{
	bool consume = POINTER_TO_INT(p1);

	while (1) {
		thread_2_counter++;
		if (consume) {
			if (k_event_wait_all_safe(&group_0, 0x00008000, false, K_FOREVER) !=
			    0x00008000) {
				return;
			}
		} else {
			if (k_event_wait_all(&group_0, 0x00008000, false, K_FOREVER) !=
			    0x00008000) {
				return;
			}
			k_event_clear(&group_0, ~0xFFFF7FFFU);
		}
	}
}

ZTEST(threadx_port, test_event_flag_suspension_different_bits)
{
	const struct tx_thread_def defs[] = {
		{ bits_thread_0, 17, true },
		{ bits_thread_1, 16, true, INT_TO_POINTER(0) },
		{ bits_thread_2, 16, true, INT_TO_POINTER(0) },
	};

	counters_reset();
	tx_run(defs, ARRAY_SIZE(defs));
}

ZTEST(threadx_port, test_event_flag_suspension_different_bits_consume)
{
	const struct tx_thread_def defs[] = {
		{ bits_thread_0, 17, true },
		{ bits_thread_1, 16, true, INT_TO_POINTER(1) },
		{ bits_thread_2, 16, true, INT_TO_POINTER(1) },
	};

	counters_reset();
	tx_run(defs, ARRAY_SIZE(defs));
}

/* threadx_event_flag_suspension_timeout_test.c: threads 1 and 2 keep
 * timing out (2 and 5 ticks) while thread 0 sleeps 63 ticks. The thread
 * order is the creation order of the original: 0, 1, 3, 2.
 */

static void timeout_thread_0(void *p1, void *p2, void *p3)
{
	thread_0_counter++;
	k_event_post(&group_0, 0x00000001);
	k_thread_start(&tx_thread[2]);     /* thread 3 */
	k_sleep(K_TICKS(1));               /* thread 3 now waits on group 0 */
	k_event_post(&group_0, 0x00000002);
	k_sleep(K_TICKS(2));
	k_thread_start(&tx_thread[1]);     /* thread 1 */
	k_thread_start(&tx_thread[3]);     /* thread 2 */
	k_sleep(K_TICKS(1));

	if (k_event_wait_all_safe(&group_0, 0x00000001, false, K_FOREVER) == 0) {
		TX_ERROR(6);
	}

	k_sleep(K_TICKS(63));

	/* The original allows 32 or 33 rounds of thread 1 and 13 or 14 of
	 * thread 2, depending on the start relative to the tick boundary.
	 */
	if ((thread_1_counter < 32) || (thread_1_counter > 33) ||
	    (thread_2_counter < 13) || (thread_2_counter > 14)) {
		printk("thread_1_counter %lu, thread_2_counter %lu\n",
		       thread_1_counter, thread_2_counter);
		TX_ERROR(7);
	}
}

static void timeout_thread_1(void *p1, void *p2, void *p3)
{
	while (1) {
		thread_1_counter++;
		if (k_event_wait_all_safe(&group_0, 0x80000000, false, K_TICKS(2)) != 0) {
			return;
		}
	}
}

static void timeout_thread_2(void *p1, void *p2, void *p3)
{
	while (1) {
		thread_2_counter++;
		if (k_event_wait_all_safe(&group_0, 0x00008000, false, K_TICKS(5)) != 0) {
			return;
		}
	}
}

static void timeout_thread_3(void *p1, void *p2, void *p3)
{
	while (1) {
		thread_3_counter++;
		if (k_event_wait_all(&group_0, 0x00000002, false, K_TICKS(5)) != 0) {
			return;
		}
	}
}

ZTEST(threadx_port, test_event_flag_suspension_timeout)
{
	const struct tx_thread_def defs[] = {
		{ timeout_thread_0, 17, true },
		{ timeout_thread_1, 16, false },
		{ timeout_thread_3, 18, false },
		{ timeout_thread_2, 16, false },
	};

	counters_reset();
	tx_run(defs, ARRAY_SIZE(defs));
}
```

## src/isr_suspend.c
```c
/*
 * SPDX-License-Identifier: Apache-2.0
 *
 * Ports of:
 * - threadx_event_flag_isr_set_clear_test.c: an ISR sets and clears flags
 *   while threads set and wait on the same group; no wakeup may be lost.
 * - threadx_thread_delayed_suspension_test.c, first part: suspending a thread
 *   that is blocked on a semaphore, then giving and resuming it.
 *
 * ThreadX calls the test ISR from its periodic timer interrupt; here a
 * one-tick k_timer does. See README.rst for what could not be kept.
 */

#include <wait_q.h>
#include "tx_port.h"

/* threadx_event_flag_isr_set_clear_test.c */

#define ISR_ROUNDS 40

static struct k_event event_flags_0;
static struct k_timer timer_0;
static struct k_timer isr_timer;
static volatile unsigned long thread_0_counter;
static volatile unsigned long thread_1_counter;
static volatile unsigned long thread_2_counter;
static volatile unsigned long timer_0_counter;
static volatile unsigned long event_flags_set_counter;
static volatile bool isr_enabled;

static int suspended_count(void)
{
	struct k_thread *t;
	int n = 0;

	_WAIT_Q_FOR_EACH(&event_flags_0.wait_q, t) {
		n++;
	}
	return n;
}

static void test_isr(struct k_timer *timer)
{
	uint32_t actual;

	if (!isr_enabled) {
		return;
	}

	if (((k_event_test(&event_flags_0, 0x3) == 0)) && (suspended_count() == 2)) {
		k_event_post(&event_flags_0, 0x3);		/* TX_OR */
		k_event_clear(&event_flags_0, 0x00000003);	/* TX_AND 0xFFFFFFFC */
		k_event_post(&event_flags_0, 0x30000);
		k_event_clear(&event_flags_0, 0x00010000);	/* TX_AND 0xFFFEFFFF */
		k_event_clear(&event_flags_0, 0x00020003);	/* TX_AND 0xFFFDFFFC */

		if (k_event_test(&event_flags_0, 0x30000) != 0) {
			return;
		}

		k_event_post(&event_flags_0, 0x000000C0);
		/* ThreadX returns the whole group in "actual"; Zephyr returns
		 * the matched bits, so read the group first.
		 */
		actual = k_event_test(&event_flags_0, 0xFFFFFFFF);
		if ((k_event_test(&event_flags_0, 0x00000080) != 0) &&
		    (k_event_wait_safe(&event_flags_0, 0x000000C0, false,
				       K_NO_WAIT) == 0xC0) &&
		    (actual == 0xC4)) {
			event_flags_set_counter++;
		}
	}
}

static void timer_0_entry(struct k_timer *timer)
{
	timer_0_counter++;
}

static void isr_thread_0(void *p1, void *p2, void *p3)
{
	isr_enabled = true;

	/* ThreadX loops until 40 ISRs have landed inside tx_event_flags_set()
	 * with preemption disabled. Zephyr's k_event calls run with
	 * interrupts locked, so an ISR on the same CPU cannot land inside
	 * one; loop until the ISR has run its sequence 40 times instead.
	 */
	while (event_flags_set_counter < ISR_ROUNDS) {
		if (k_event_wait_safe(&event_flags_0, 2, false, TX_TICKS(4)) == 0) {
			TX_ERROR(8);
			isr_enabled = false;
			return;
		}
		thread_0_counter++;
	}

	isr_enabled = false;
	k_yield();

	if ((thread_0_counter != event_flags_set_counter) ||
	    (thread_1_counter != event_flags_set_counter)) {
		printk("thread_0_counter %lu, thread_1_counter %lu, ISR rounds %lu\n",
		       thread_0_counter, thread_1_counter, event_flags_set_counter);
		TX_ERROR(10);
	}
}

static void isr_thread_1(void *p1, void *p2, void *p3)
{
	while (true) {
		if (k_event_wait_safe(&event_flags_0, 1, false, TX_TICKS(4)) == 0) {
			break;
		}
		thread_1_counter++;
	}
}

static void isr_thread_2(void *p1, void *p2, void *p3)
{
	while (true) {
		k_event_post(&event_flags_0, 0x4);
		thread_2_counter++;
		k_yield();
	}
}

ZTEST(threadx_port, test_event_flag_isr_set_clear)
{
	/* The original creates thread 2 first, so it runs (and sets 0x4,
	 * which the ISR expects to see) before threads 0 and 1 block.
	 */
	static const struct tx_thread_def defs[] = {
		{ isr_thread_2, 17, true },
		{ isr_thread_0, 17, true },
		{ isr_thread_1, 17, true },
	};

	thread_0_counter = 0;
	thread_1_counter = 0;
	thread_2_counter = 0;
	timer_0_counter = 0;
	event_flags_set_counter = 0;
	isr_enabled = false;
	k_event_init(&event_flags_0);
	k_timer_init(&timer_0, timer_0_entry, NULL);
	k_timer_init(&isr_timer, test_isr, NULL);
	k_timer_start(&timer_0, K_TICKS(1), K_TICKS(1));
	k_timer_start(&isr_timer, K_TICKS(1), K_TICKS(1));

	tx_run_main(defs, ARRAY_SIZE(defs), 1);

	k_timer_stop(&isr_timer);
	k_timer_stop(&timer_0);
	TC_PRINT("ISR rounds %lu, thread 2 sets %lu\n", event_flags_set_counter,
		 thread_2_counter);
}

/* threadx_thread_delayed_suspension_test.c, first part */

static struct k_sem semaphore_0;
static volatile unsigned long thread_1_gets;

static void delayed_thread_0(void *p1, void *p2, void *p3)
{
	k_yield();

	/* Thread 1 is blocked on semaphore 0: suspend it, give, resume. */
	k_thread_suspend(&tx_thread[1]);
	k_sem_give(&semaphore_0);
	k_thread_resume(&tx_thread[1]);
	k_yield();

	/* Zephyr port: thread 1 took that give exactly once and blocks again. */
	if (thread_1_gets != 1) {
		TX_ERROR(100);
		return;
	}

	/* Suspend and resume it while blocked. ThreadX returns
	 * TX_SUSPEND_LIFTED: only the suspension is lifted and the thread
	 * stays blocked on the semaphore.
	 */
	k_thread_suspend(&tx_thread[1]);
	k_thread_resume(&tx_thread[1]);
	if (!tx_state(&tx_thread[1], _THREAD_PENDING) ||
	    tx_state(&tx_thread[1], _THREAD_SUSPENDED)) {
		TX_ERROR(4);
		return;
	}

	/* Zephyr port: it still takes the next give. */
	k_sem_give(&semaphore_0);
	k_yield();
	if (thread_1_gets != 2) {
		TX_ERROR(101);
	}
}

static void delayed_thread_1(void *p1, void *p2, void *p3)
{
	while (true) {
		if (k_sem_take(&semaphore_0, K_FOREVER) != 0) {
			break;
		}
		thread_1_gets++;
	}
}

ZTEST(threadx_port, test_thread_delayed_suspension)
{
	static const struct tx_thread_def defs[] = {
		{ delayed_thread_0, 2, true },
		{ delayed_thread_1, 2, true },
	};

	thread_1_gets = 0;
	k_sem_init(&semaphore_0, 0, K_SEM_MAX_LIMIT);
	tx_run(defs, ARRAY_SIZE(defs));
}
```

## src/terminate.c
```c
/*
 * SPDX-License-Identifier: Apache-2.0
 *
 * Ports of the ThreadX "thread terminate while suspended on an object" tests:
 * a thread blocked on a kernel object is terminated (k_thread_abort()), and
 * the object must be left clean. tx_thread_terminate() maps to
 * k_thread_abort(), tx_thread_relinquish() to k_yield(), and ThreadX ticks to
 * K_TICKS(). Checks marked "Zephyr port" are not in the original; see
 * README.rst.
 */

#include <wait_q.h>
#include "tx_port.h"

static volatile unsigned long thread_0_counter;
static volatile unsigned long thread_1_counter;
static volatile unsigned long thread_2_counter;

static void reset_counters(void)
{
	thread_0_counter = 0;
	thread_1_counter = 0;
	thread_2_counter = 0;
}

/* Zephyr port: the terminated waiters left the wait queue and their timeouts
 * do not fire after the abort.
 */
static void check_waitq_empty(_wait_q_t *wq, int err)
{
	if (z_waitq_head(wq) != NULL) {
		TX_ERROR(err);
	}
}

/* threadx_semaphore_thread_terminate_test.c */

static struct k_sem semaphore_0;

static void sem_thread_0(void *p1, void *p2, void *p3)
{
	thread_0_counter++;
	k_yield();

	if ((thread_1_counter != 1) || (thread_2_counter != 1)) {
		TX_ERROR(7);
		return;
	}

	k_thread_abort(&tx_thread[1]);
	if ((thread_1_counter != 1) || (thread_2_counter != 1)) {
		TX_ERROR(8);
		return;
	}

	k_thread_abort(&tx_thread[2]);
	k_yield();
	if ((thread_1_counter != 1) || (thread_2_counter != 1)) {
		TX_ERROR(9);
		return;
	}

	/* Zephyr port: past both timeouts, the waiters stay gone and the
	 * semaphore still counts.
	 */
	check_waitq_empty(&semaphore_0.wait_q, 100);
	k_sleep(K_TICKS(50));
	if ((thread_1_counter != 1) || (thread_2_counter != 1)) {
		TX_ERROR(101);
	}
	k_sem_give(&semaphore_0);
	if (k_sem_take(&semaphore_0, K_NO_WAIT) != 0) {
		TX_ERROR(102);
	}
}

static void sem_thread_1(void *p1, void *p2, void *p3)
{
	thread_1_counter++;
	k_sem_take(&semaphore_0, K_TICKS(33));
	thread_1_counter++;
}

static void sem_thread_2(void *p1, void *p2, void *p3)
{
	thread_2_counter++;
	k_sem_take(&semaphore_0, K_TICKS(44));
	thread_2_counter++;
}

ZTEST(threadx_port, test_semaphore_thread_terminate)
{
	static const struct tx_thread_def defs[] = {
		{ sem_thread_0, 16, true },
		{ sem_thread_1, 16, true },
		{ sem_thread_2, 16, true },
	};

	reset_counters();
	k_sem_init(&semaphore_0, 0, K_SEM_MAX_LIMIT);
	tx_run(defs, ARRAY_SIZE(defs));
}

/* threadx_mutex_thread_terminate_test.c */

static struct k_mutex mutex_0;

static void mutex_thread_0(void *p1, void *p2, void *p3)
{
	thread_0_counter++;
	k_yield();

	if ((thread_1_counter != 1) || (thread_2_counter != 1)) {
		TX_ERROR(7);
		return;
	}

	k_thread_abort(&tx_thread[1]);
	if ((thread_1_counter != 1) || (thread_2_counter != 1)) {
		TX_ERROR(8);
		return;
	}

	k_thread_abort(&tx_thread[2]);
	k_yield();
	if ((thread_1_counter != 1) || (thread_2_counter != 1)) {
		TX_ERROR(9);
		return;
	}

	check_waitq_empty(&mutex_0.wait_q, 100);
	k_sleep(K_TICKS(50));
	if ((thread_1_counter != 1) || (thread_2_counter != 1)) {
		TX_ERROR(101);
	}
}

static void mutex_thread_1(void *p1, void *p2, void *p3)
{
	thread_1_counter++;
	k_mutex_lock(&mutex_0, K_TICKS(33));
	thread_1_counter++;
}

static void mutex_thread_2(void *p1, void *p2, void *p3)
{
	thread_2_counter++;
	k_mutex_lock(&mutex_0, K_TICKS(44));
	thread_2_counter++;
}

ZTEST(threadx_port, test_mutex_thread_terminate)
{
	static const struct tx_thread_def defs[] = {
		{ mutex_thread_0, 16, true },
		{ mutex_thread_1, 16, true },
		{ mutex_thread_2, 16, true },
	};
	int prio = k_thread_priority_get(k_current_get());

	reset_counters();
	k_mutex_init(&mutex_0);
	/* ThreadX takes the mutex in tx_application_define(); the ztest
	 * thread is the owner here.
	 */
	k_mutex_lock(&mutex_0, K_NO_WAIT);
	tx_run(defs, ARRAY_SIZE(defs));

	/* Zephyr port: the owner can still release it and was not left with
	 * a boost from the dead waiters.
	 */
	zassert_equal(k_thread_priority_get(k_current_get()), prio);
	zassert_equal(k_mutex_unlock(&mutex_0), 0);
	zassert_equal(k_mutex_lock(&mutex_0, K_NO_WAIT), 0);
	zassert_equal(k_mutex_unlock(&mutex_0), 0);
}

/* threadx_queue_thread_terminate_test.c */

static struct k_msgq queue_0;
static char __aligned(4) queue_0_buf[3 * 2 * sizeof(uint32_t)];

static void queue_thread_0(void *p1, void *p2, void *p3)
{
	thread_0_counter++;

	if (!tx_state(&tx_thread[1], _THREAD_PENDING)) {
		TX_ERROR(5);
		return;
	}

	k_thread_abort(&tx_thread[1]);
	if (!tx_state(&tx_thread[1], _THREAD_DEAD) || (thread_1_counter != 0) ||
	    (z_waitq_head(&queue_0.wait_q) != NULL)) {
		TX_ERROR(6);
		return;
	}

	/* Zephyr port: a message sent now stays in the queue. */
	uint32_t msg[2] = { 0x12345678, 0 };
	uint32_t out[2];

	if ((k_msgq_put(&queue_0, msg, K_NO_WAIT) != 0) ||
	    (k_msgq_num_used_get(&queue_0) != 1) ||
	    (k_msgq_get(&queue_0, out, K_NO_WAIT) != 0) || (out[0] != msg[0])) {
		TX_ERROR(100);
	}
}

static void queue_thread_1(void *p1, void *p2, void *p3)
{
	uint32_t dest_message[2];

	while (true) {
		if (k_msgq_get(&queue_0, dest_message, K_FOREVER) != -ENOMSG) {
			break;
		}
		thread_1_counter++;
	}
}

ZTEST(threadx_port, test_queue_thread_terminate)
{
	static const struct tx_thread_def defs[] = {
		{ queue_thread_0, 17, true },
		{ queue_thread_1, 16, true },
	};

	reset_counters();
	k_msgq_init(&queue_0, queue_0_buf, 2 * sizeof(uint32_t), 3);
	tx_run(defs, ARRAY_SIZE(defs));
}

/* threadx_block_memory_thread_terminate_test.c */

/* ThreadX uses 100-byte blocks; Zephyr needs a multiple of the pointer size. */
#define BLOCK_SIZE ROUND_UP(100, sizeof(void *))
static struct k_mem_slab pool_0;
static char __aligned(8) pool_0_buf[3 * BLOCK_SIZE];

static void block_thread_0(void *p1, void *p2, void *p3)
{
	void *pointer_1;
	void *pointer_2;
	void *pointer_3;
	int status;

	status = k_mem_slab_alloc(&pool_0, &pointer_1, K_NO_WAIT);
	status |= k_mem_slab_alloc(&pool_0, &pointer_2, K_NO_WAIT);
	status |= k_mem_slab_alloc(&pool_0, &pointer_3, K_NO_WAIT);
	thread_0_counter++;
	if (status != 0) {
		TX_ERROR(5);
		return;
	}

	memset(pointer_1, 0xEF, BLOCK_SIZE);
	memset(pointer_2, 0xEF, BLOCK_SIZE);
	memset(pointer_3, 0xEF, BLOCK_SIZE);

	k_yield();

	k_thread_abort(&tx_thread[1]);
	if (!tx_state(&tx_thread[1], _THREAD_DEAD) || (thread_1_counter != 0)) {
		TX_ERROR(6);
		return;
	}

	k_mem_slab_free(&pool_0, pointer_1);
	k_mem_slab_free(&pool_0, pointer_2);
	k_mem_slab_free(&pool_0, pointer_3);
	if (!tx_state(&tx_thread[1], _THREAD_DEAD) || (thread_1_counter != 0)) {
		TX_ERROR(7);
		return;
	}

	/* Zephyr port: no block went to the dead waiter. */
	if (k_mem_slab_num_free_get(&pool_0) != 3) {
		TX_ERROR(100);
	}
}

static void block_thread_1(void *p1, void *p2, void *p3)
{
	void *pointer_1;

	while (true) {
		if (k_mem_slab_alloc(&pool_0, &pointer_1, K_TICKS(10)) != -EAGAIN) {
			return;
		}
		thread_1_counter++;
	}
}

ZTEST(threadx_port, test_block_memory_thread_terminate)
{
	static const struct tx_thread_def defs[] = {
		{ block_thread_0, 17, true },
		{ block_thread_1, 17, true },
	};

	reset_counters();
	zassert_ok(k_mem_slab_init(&pool_0, pool_0_buf, BLOCK_SIZE, 3));
	tx_run(defs, ARRAY_SIZE(defs));
}

/* threadx_byte_memory_thread_terminate_test.c */

#define BYTE_ALLOC 60
static struct k_heap heap_0;
static char __aligned(8) heap_0_buf[512];

/* ThreadX sizes the pool (108 bytes) so that one 60-byte block fits and a
 * second does not. Zephyr's heap overhead differs, so find that size here.
 */
static void heap_0_init_one_block(void)
{
	for (size_t sz = BYTE_ALLOC; sz <= sizeof(heap_0_buf); sz += 4) {
		k_heap_init(&heap_0, heap_0_buf, sz);
		void *p = k_heap_alloc(&heap_0, BYTE_ALLOC, K_NO_WAIT);

		if (p != NULL) {
			void *q = k_heap_alloc(&heap_0, BYTE_ALLOC, K_NO_WAIT);

			zassert_is_null(q, "two blocks fit in %zu bytes", sz);
			k_heap_free(&heap_0, p);
			return;
		}
	}
	zassert_unreachable("no heap size fits one block");
}

static void byte_thread_0(void *p1, void *p2, void *p3)
{
	void *pointer;

	thread_0_counter++;
	pointer = k_heap_alloc(&heap_0, BYTE_ALLOC, K_NO_WAIT);
	if (pointer == NULL) {
		TX_ERROR(5);
		return;
	}

	k_yield();

	k_thread_abort(&tx_thread[1]);
	k_heap_free(&heap_0, pointer);

	pointer = k_heap_alloc(&heap_0, BYTE_ALLOC, K_NO_WAIT);
	if ((pointer == NULL) || (thread_1_counter != 0)) {
		TX_ERROR(6);
		return;
	}
	k_heap_free(&heap_0, pointer);
}

static void byte_thread_1(void *p1, void *p2, void *p3)
{
	while (true) {
		if (k_heap_alloc(&heap_0, BYTE_ALLOC, K_FOREVER) != NULL) {
			return;
		}
		thread_1_counter++;
	}
}

ZTEST(threadx_port, test_byte_memory_thread_terminate)
{
	static const struct tx_thread_def defs[] = {
		{ byte_thread_0, 17, true },
		{ byte_thread_1, 17, true },
	};

	reset_counters();
	heap_0_init_one_block();
	tx_run(defs, ARRAY_SIZE(defs));
}

/* threadx_event_flag_thread_terminate_test.c */

static struct k_event group_0;

static void event_thread_0(void *p1, void *p2, void *p3)
{
	thread_0_counter++;

	k_thread_abort(&tx_thread[2]);
	k_thread_abort(&tx_thread[1]);
	k_event_post(&group_0, 0xFFFFFFFF);

	if ((thread_1_counter != 1) || (thread_2_counter != 1)) {
		TX_ERROR(7);
		return;
	}

	/* Zephyr port: the dead waiters consumed nothing. */
	if (k_event_test(&group_0, 0xFFFFFFFF) != 0xFFFFFFFF) {
		TX_ERROR(100);
	}
	check_waitq_empty(&group_0.wait_q, 101);
}

static void event_thread_1(void *p1, void *p2, void *p3)
{
	while (true) {
		thread_1_counter++;
		/* TX_AND_CLEAR */
		if (k_event_wait_all_safe(&group_0, 0x80000000, false,
					  K_FOREVER) == 0) {
			return;
		}
	}
}

static void event_thread_2(void *p1, void *p2, void *p3)
{
	while (true) {
		thread_2_counter++;
		if (k_event_wait_all_safe(&group_0, 0x00008000, false,
					  K_FOREVER) == 0) {
			return;
		}
	}
}

ZTEST(threadx_port, test_event_flag_thread_terminate)
{
	static const struct tx_thread_def defs[] = {
		{ event_thread_0, 17, true },
		{ event_thread_1, 16, true },
		{ event_thread_2, 16, true },
	};

	reset_counters();
	k_event_init(&group_0);
	tx_run(defs, ARRAY_SIZE(defs));
}

/* threadx_event_flag_single_thread_terminate_test.c
 *
 * The original's middle checks use "&&" and so can only fail on a bad
 * status; they are kept as written. The last checks use "||".
 */

static void single_thread_0(void *p1, void *p2, void *p3)
{
	thread_0_counter++;
	k_sleep(K_TICKS(5));

	k_thread_start(&tx_thread[2]);	/* tx_thread_resume() of TX_DONT_START */
	k_thread_abort(&tx_thread[1]);	/* thread 1 has suspended itself */
	k_sleep(K_TICKS(5));

	k_event_post(&group_0, 0x00080000);
	k_sleep(K_TICKS(5));

	k_event_post(&group_0, 0x00800000);
	k_sleep(K_TICKS(5));

	/* Thread 2 waits again; set a flag it does not need. */
	k_event_post(&group_0, 0x00000001);
	k_sleep(K_TICKS(5));

	k_event_post(&group_0, 0x00080001);
	k_sleep(K_TICKS(5));

	if ((thread_1_counter != 1) || (thread_2_counter != 3)) {
		TX_ERROR(12);
		return;
	}

	k_thread_abort(&tx_thread[2]);
	if (thread_2_counter != 3) {
		TX_ERROR(13);
	}
}

static void single_thread_1(void *p1, void *p2, void *p3)
{
	while (true) {
		thread_1_counter++;
		k_thread_suspend(k_current_get());
	}
}

static void single_thread_2(void *p1, void *p2, void *p3)
{
	while (true) {
		thread_2_counter++;
		/* TX_AND_CLEAR */
		if (k_event_wait_all_safe(&group_0, 0x00880000, false,
					  K_FOREVER) == 0) {
			return;
		}
		thread_2_counter++;
		/* TX_OR_CLEAR */
		if (k_event_wait_safe(&group_0, 0x00880000, false,
				      K_FOREVER) == 0) {
			return;
		}
		thread_2_counter++;
		/* The original expects TX_NO_EVENTS here and returns on
		 * anything else; it is never satisfied in the test.
		 */
		if (k_event_wait_all_safe(&group_0, 0x00880000, false,
					  K_FOREVER) != 0) {
			return;
		}
	}
}

ZTEST(threadx_port, test_event_flag_single_thread_terminate)
{
	static const struct tx_thread_def defs[] = {
		{ single_thread_0, 17, true },
		{ single_thread_1, 18, true },
		{ single_thread_2, 18, false },
	};

	reset_counters();
	k_event_init(&group_0);
	tx_run(defs, ARRAY_SIZE(defs));
}

/* threadx_thread_sleep_terminate_test.c */

static void sleep_thread_0(void *p1, void *p2, void *p3)
{
	thread_0_counter++;
	k_sleep(K_TICKS(5));

	k_thread_abort(&tx_thread[1]);
	if (thread_1_counter != 1) {
		TX_ERROR(3);
		return;
	}

	/* ThreadX: tx_thread_suspend() of a terminated thread returns
	 * TX_SUSPEND_ERROR and does nothing. k_thread_suspend() has no return
	 * value (and does set the suspended flag on a dead thread), so check
	 * that the thread stays dead and a resume does not run it again.
	 */
	k_thread_suspend(&tx_thread[1]);
	k_thread_resume(&tx_thread[1]);
	k_yield();
	if (!tx_state(&tx_thread[1], _THREAD_DEAD) || (thread_1_counter != 1)) {
		TX_ERROR(4);
		return;
	}

	/* Zephyr port: past the 100-tick sleep, it never ran again. */
	k_sleep(K_TICKS(110));
	if (thread_1_counter != 1) {
		TX_ERROR(100);
	}
}

static void sleep_thread_1(void *p1, void *p2, void *p3)
{
	while (true) {
		thread_1_counter++;
		k_sleep(K_TICKS(100));
	}
}

ZTEST(threadx_port, test_thread_sleep_terminate)
{
	static const struct tx_thread_def defs[] = {
		{ sleep_thread_0, 17, true },
		{ sleep_thread_1, 18, true },
	};

	reset_counters();
	tx_run(defs, ARRAY_SIZE(defs));
}
```

## src/tx_port.h
```c
/*
 * SPDX-License-Identifier: Apache-2.0
 *
 * Helpers shared by the ports of the ThreadX regression tests
 * (eclipse-threadx/threadx, test/tx/regression).
 *
 * A ThreadX test creates its threads in tx_application_define(), before the
 * scheduler runs, and reports through test_control_return(). Here the ztest
 * thread creates the same threads with the same priorities (ThreadX and
 * Zephyr both run lower numbers first), starts them in creation order with
 * the scheduler locked, and then waits for thread 0. The first ThreadX error
 * number hit is kept and checked by the ztest thread.
 */

#ifndef TX_PORT_H_
#define TX_PORT_H_

#include <zephyr/kernel.h>
#include <zephyr/ztest.h>

#define TX_THREADS     3
#define TX_STACK_SIZE  (1024 + CONFIG_TEST_EXTRA_STACK_SIZE)

extern struct k_thread tx_thread[TX_THREADS];
extern volatile int tx_error;

/* Record the first failing ThreadX error number. */
#define TX_ERROR(n)                                                          \
	do {                                                                 \
		if (tx_error == 0) {                                         \
			tx_error = (n);                                      \
		}                                                            \
	} while (false)

struct tx_thread_def {
	k_thread_entry_t entry;
	int prio;
	bool auto_start;
};

/* Create the threads as tx_application_define() would and run the test
 * until thread 0 returns. Fails the test on a recorded error or a hang.
 */
void tx_run(const struct tx_thread_def *defs, int n);

/* Same, for tests that do not create thread 0 first: wait for defs[main_idx] */
void tx_run_main(const struct tx_thread_def *defs, int n, int main_idx);

/* The ThreadX regression tests run at TX_TIMER_TICKS_PER_SECOND (100 by
 * default). Timeouts that only bound how long a thread may take to get
 * scheduled are converted at that rate, so that a faster Zephyr tick does
 * not shorten them.
 */
#define TX_TICK_MS   10
#define TX_TICKS(n)  K_MSEC((n) * TX_TICK_MS)

static inline bool tx_state(struct k_thread *t, uint8_t flag)
{
	return (t->base.thread_state & flag) != 0U;
}

#endif /* TX_PORT_H_ */
```
