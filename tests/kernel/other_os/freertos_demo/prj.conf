## CMakeLists.txt
```
# SPDX-License-Identifier: Apache-2.0

cmake_minimum_required(VERSION 3.20.0)
find_package(Zephyr REQUIRED HINTS $ENV{ZEPHYR_BASE})
project(freertos_demo)

target_sources(app PRIVATE src/main.c src/queues.c src/sync.c src/tasks.c
			    src/events.c)
```

## Kconfig
```
# SPDX-License-Identifier: Apache-2.0

config FREERTOS_DEMO_DURATION_S
	int "How long to run the demo (s)"
	default 60
	help
	  The FreeRTOS demo runs until stopped; the check runs every 10 s.

config FREERTOS_DEMO_MODULES
	hex "Demo modules to run (bit mask)"
	default 0x3ff
	help
	  Bit 0 BlockQ, 1 semtest, 2 PollQ, 3 integer, 4 recmutex, 5 countsem,
	  6 dynamic, 7 blocktim, 8 death, 9 EventGroups.

config FREERTOS_DEMO_BLOCKTIM_REFILL
	bool "Run blocktim's make-room-and-refill steps"
	help
	  They rely on a FreeRTOS queue leaving an item in the queue for a
	  higher priority task to take back; a k_msgq hands it straight to
	  the blocked thread, so they fail on Zephyr by design.

source "Kconfig.zephyr"
```

## prj.conf
```kconfig
CONFIG_ZTEST=y
CONFIG_ZTEST_STACK_SIZE=2048
# configTICK_RATE_HZ, configMAX_PRIORITIES and time slicing of equal
# priorities at every tick, as in the demo's FreeRTOSConfig.h
CONFIG_SYS_CLOCK_TICKS_PER_SEC=1000
CONFIG_NUM_PREEMPT_PRIORITIES=7
CONFIG_TIMESLICING=y
CONFIG_TIMESLICE_SIZE=1
CONFIG_TIMESLICE_PRIORITY=0
CONFIG_THREAD_MONITOR=y
CONFIG_THREAD_NAME=y
CONFIG_ASSERT=y
CONFIG_EVENTS=y
```

## src/main.c
```c
/*
 * SPDX-License-Identifier: Apache-2.0
 *
 * The FreeRTOS full demo as a Zephyr soak test: start the demo modules in
 * the order of Demo/Posix_GCC/main_full.c, then, like its check task, call
 * every module's check each mainCHECK_PERIOD_MS. Any failed check fails the
 * run; the run lasts CONFIG_FREERTOS_DEMO_DURATION_S.
 */

#include <zephyr/ztest.h>
#include "demo.h"

#define MAX_TASKS 32

static K_THREAD_STACK_ARRAY_DEFINE(task_stack, MAX_TASKS, FR_STACK_SIZE);
static struct k_thread task_thread[MAX_TASKS];
static int n_tasks;

k_tid_t fr_task_create(k_thread_entry_t entry, const char *name, void *arg,
		       int fr_prio, bool pin0)
{
	__ASSERT(n_tasks < MAX_TASKS, "too many demo tasks");
	struct k_thread *t = &task_thread[n_tasks];

	k_thread_create(t, task_stack[n_tasks], FR_STACK_SIZE, entry, arg, NULL, NULL,
			FR_PRIO(fr_prio), 0, K_FOREVER);
	n_tasks++;
	k_thread_name_set(t, name);
#ifdef CONFIG_SCHED_CPU_MASK
	if (pin0) {
		k_thread_cpu_pin(t, 0);
	}
#endif
	k_thread_start(t);
	return t;
}

struct check {
	const char *name;
	bool (*fn)(void);
	int module;
};

enum { M_BLOCKQ, M_SEMTEST, M_POLLQ, M_INTEGER, M_RECMUTEX, M_COUNTSEM, M_DYNAMIC,
       M_BLOCKTIM, M_DEATH, M_EVENTS };

#define ON(m) ((CONFIG_FREERTOS_DEMO_MODULES & BIT(m)) != 0)

static const struct check checks[] = {
	{ "xIsCreateTaskStillRunning", xIsCreateTaskStillRunning, M_DEATH },
	{ "xAreBlockTimeTestTasksStillRunning", xAreBlockTimeTestTasksStillRunning, M_BLOCKTIM },
	{ "xAreSemaphoreTasksStillRunning", xAreSemaphoreTasksStillRunning, M_SEMTEST },
	{ "xArePollingQueuesStillRunning", xArePollingQueuesStillRunning, M_POLLQ },
	{ "xAreIntegerMathsTaskStillRunning", xAreIntegerMathsTaskStillRunning, M_INTEGER },
	{ "xAreRecursiveMutexTasksStillRunning", xAreRecursiveMutexTasksStillRunning, M_RECMUTEX },
	{ "xAreBlockingQueuesStillRunning", xAreBlockingQueuesStillRunning, M_BLOCKQ },
	{ "xAreCountingSemaphoreTasksStillRunning", xAreCountingSemaphoreTasksStillRunning,
	  M_COUNTSEM },
	{ "xAreDynamicPriorityTasksStillRunning", xAreDynamicPriorityTasksStillRunning,
	  M_DYNAMIC },
	{ "xAreEventGroupTasksStillRunning", xAreEventGroupTasksStillRunning, M_EVENTS },
};

ZTEST(freertos_demo, test_full_demo)
{
	int64_t end = k_uptime_get() + CONFIG_FREERTOS_DEMO_DURATION_S * MSEC_PER_SEC;
	int64_t next = k_uptime_get();
	int failures = 0, rounds = 0;

	/* The check task runs at mainCHECK_TASK_PRIORITY. */
	k_thread_priority_set(k_current_get(), FR_PRIO(mainCHECK_TASK_PRIORITY));

	if (ON(M_BLOCKQ)) {
		vStartBlockingQueueTasks(mainBLOCK_Q_PRIORITY);
	}
	if (ON(M_SEMTEST)) {
		vStartSemaphoreTasks(mainSEM_TEST_PRIORITY);
	}
	if (ON(M_POLLQ)) {
		vStartPolledQueueTasks(mainQUEUE_POLL_PRIORITY);
	}
	if (ON(M_INTEGER)) {
		vStartIntegerMathTasks(mainINTEGER_TASK_PRIORITY);
	}
	if (ON(M_RECMUTEX)) {
		vStartRecursiveMutexTasks();
	}
	if (ON(M_COUNTSEM)) {
		vStartCountingSemaphoreTasks();
	}
	if (ON(M_DYNAMIC)) {
		vStartDynamicPriorityTasks();
	}
	if (ON(M_BLOCKTIM)) {
		vCreateBlockTimeTasks();
	}
	if (ON(M_EVENTS)) {
		vStartEventGroupTasks();
	}
	/* Last, so the task count it records at start includes the others. */
	if (ON(M_DEATH)) {
		vCreateSuicidalTasks(mainCREATOR_TASK_PRIORITY);
	}

	while (k_uptime_get() < end) {
		next += mainCHECK_PERIOD_MS;
		k_sleep(K_TIMEOUT_ABS_MS(next));
		rounds++;

		const char *pcMessage = "PASS";

		for (size_t i = 0; i < ARRAY_SIZE(checks); i++) {
			if (!ON(checks[i].module)) {
				continue;
			}
			if (!checks[i].fn()) {
				pcMessage = checks[i].name;
				failures++;
				printk("check %d: %s() returned false\n", rounds, checks[i].name);
			}
		}
		printk("check %d at %lld s: %s\n", rounds, k_uptime_get() / MSEC_PER_SEC,
		       pcMessage);
	}

	for (int i = 0; i < n_tasks; i++) {
		k_thread_abort(&task_thread[i]);
	}
	zassert_equal(failures, 0, "%d failed checks in %d rounds", failures, rounds);
}

ZTEST_SUITE(freertos_demo, NULL, NULL, NULL, NULL, NULL);
```

## src/demo.h
```c
/*
 * SPDX-License-Identifier: Apache-2.0
 *
 * Shared definitions for the port of the FreeRTOS standard demo tasks
 * (FreeRTOS/Demo/Common/Minimal). Each module keeps its tasks, priorities,
 * delays (in ticks; the app runs at 1000 ticks per second, as the demos do)
 * and its xAre...StillRunning()
 * check; a check thread calls every check periodically, as the demos'
 * check task does.
 */

#ifndef DEMO_H_
#define DEMO_H_

#include <zephyr/kernel.h>

/* FreeRTOS priorities count up from tskIDLE_PRIORITY (0) to
 * configMAX_PRIORITIES - 1; Zephyr's count down. The demos use
 * configMAX_PRIORITIES = 7.
 */
#define tskIDLE_PRIORITY     0
#define configMAX_PRIORITIES 7
#define FR_PRIO(p)           ((configMAX_PRIORITIES - 1) - (p))

#define FR_STACK_SIZE (1024 + CONFIG_TEST_EXTRA_STACK_SIZE)

/* Priorities and check period from Demo/Posix_GCC/main_full.c and
 * FreeRTOSConfig.h (configMAX_PRIORITIES 7, configTICK_RATE_HZ 1000,
 * configTIMER_TASK_PRIORITY configMAX_PRIORITIES - 1).
 */
#define configTIMER_TASK_PRIORITY (configMAX_PRIORITIES - 1)
#define mainCHECK_TASK_PRIORITY   (configMAX_PRIORITIES - 2)
#define mainCHECK_PERIOD_MS       10000
#define mainQUEUE_POLL_PRIORITY   (tskIDLE_PRIORITY + 1)
#define mainSEM_TEST_PRIORITY     (tskIDLE_PRIORITY + 1)
#define mainBLOCK_Q_PRIORITY      (tskIDLE_PRIORITY + 2)
#define mainCREATOR_TASK_PRIORITY (tskIDLE_PRIORITY + 3)
#define mainINTEGER_TASK_PRIORITY (tskIDLE_PRIORITY)

/* Create and start a demo task. pin0: on SMP, keep it on CPU 0 (see
 * README.rst: FreeRTOS SMP by default never runs tasks of different
 * priorities at once, Zephyr has no such mode).
 */
k_tid_t fr_task_create(k_thread_entry_t entry, const char *name, void *arg,
		       int fr_prio, bool pin0);

/* configASSERT() in the demos halts; here it records an error. */
#define FR_ASSERT(err, cond)                                                 \
	do {                                                                 \
		if (!(cond)) {                                               \
			(err) = __LINE__;                                    \
		}                                                            \
	} while (false)

static inline bool fr_is_suspended(k_tid_t t)
{
	return (t->base.thread_state & _THREAD_SUSPENDED) != 0U;
}

void vStartPolledQueueTasks(int uxPriority);
bool xArePollingQueuesStillRunning(void);
void vStartSemaphoreTasks(int uxPriority);
bool xAreSemaphoreTasksStillRunning(void);
void vStartCountingSemaphoreTasks(void);
bool xAreCountingSemaphoreTasksStillRunning(void);
void vStartBlockingQueueTasks(int uxPriority);
bool xAreBlockingQueuesStillRunning(void);
void vStartRecursiveMutexTasks(void);
bool xAreRecursiveMutexTasksStillRunning(void);
void vStartIntegerMathTasks(int uxPriority);
bool xAreIntegerMathsTaskStillRunning(void);
void vCreateSuicidalTasks(int uxPriority);
bool xIsCreateTaskStillRunning(void);
void vStartDynamicPriorityTasks(void);
bool xAreDynamicPriorityTasksStillRunning(void);
void vCreateBlockTimeTasks(void);
bool xAreBlockTimeTestTasksStillRunning(void);
void vStartEventGroupTasks(void);
bool xAreEventGroupTasksStillRunning(void);

#endif /* DEMO_H_ */
```

## src/events.c
```c
/*
 * SPDX-License-Identifier: Apache-2.0
 *
 * Port of FreeRTOS/Demo/Common/Minimal/EventGroupsDemo.c on k_event.
 *
 * FreeRTOS -> Zephyr:
 * - xEventGroupWaitBits(clear, all)  k_event_wait{,_all}{,_safe}()
 * - xEventGroupSetBits()             k_event_post()
 * - xEventGroupClearBits()           k_event_clear()
 * - xEventGroupGetBits(), SetBits(0) k_event_test(~0)
 * - *FromISR() from the tick hook    the same calls from a one-tick k_timer
 * - xEventGroupSync()                eg_sync() below
 * - eTaskGetState()                  fr_state() below
 * Differences (see README.rst):
 * - xEventGroupWaitBits() returns the whole group as it was when the
 *   task unblocked; k_event_wait*() returns the requested bits that
 *   matched. Checks of the return value compare against the requested bits.
 * - vEventGroupDelete() unblocks its waiters with 0. A k_event cannot be
 *   deleted: "deleting" posts EG_DELETED, which the waits that the demo
 *   expects to end that way also wait for, and which then reads as 0.
 * - xEventGroupSetBits() and xEventGroupClearBits() return the group after
 *   the set or before the clear; the checks read it with k_event_test().
 */

#include <zephyr/kernel.h>
#include "demo.h"

#define ebSET_BIT_TASK_PRIORITY      (tskIDLE_PRIORITY)
#define ebWAIT_BIT_TASK_PRIORITY     (tskIDLE_PRIORITY + 1)

#define ebBIT_0 0x01
#define ebBIT_1 0x02
#define ebBIT_2 0x04
#define ebBIT_3 0x08
#define ebBIT_4 0x10
#define ebBIT_5 0x20
#define ebBIT_6 0x40
#define ebBIT_7 0x80

#define ebCOMBINED_BITS (ebBIT_1 | ebBIT_5 | ebBIT_7)
#define ebALL_BITS      (ebBIT_0 | ebBIT_1 | ebBIT_2 | ebBIT_3 | ebBIT_4 | ebBIT_5 | \
			 ebBIT_6 | ebBIT_7)

#define ebSET_BIT_TASK_SYNC_BIT      ebBIT_0
#define ebWAIT_BIT_TASK_SYNC_BIT     ebBIT_1
#define ebRENDEZVOUS_TASK_1_SYNC_BIT ebBIT_2
#define ebRENDEZVOUS_TASK_2_SYNC_BIT ebBIT_3
#define ebALL_SYNC_BITS              (ebSET_BIT_TASK_SYNC_BIT | ebWAIT_BIT_TASK_SYNC_BIT | \
				      ebRENDEZVOUS_TASK_1_SYNC_BIT | \
				      ebRENDEZVOUS_TASK_2_SYNC_BIT)

#define ebSELECTIVE_BITS_1 0x03
#define ebSELECTIVE_BITS_2 0x05

/* Not one of the demo's bits: marks a "deleted" group */
#define EG_DELETED ((uint32_t)BIT(24))

enum fr_state { eReady, eBlocked, eSuspended };

static volatile uint32_t ulTestMasterCycles, ulTestSlaveCycles, ulISRCycles;
static struct k_event xEventGroup;
static struct k_event xISREventGroup;
static k_tid_t xSyncTask1, xSyncTask2;
static volatile int eg_error_line;

#define EG_ERROR()                                                           \
	do {                                                                 \
		if (eg_error_line == 0) {                                    \
			eg_error_line = __LINE__;                            \
			printk("EventGroups: error at line %d\n", __LINE__); \
		}                                                            \
	} while (false)

static enum fr_state fr_state(k_tid_t t)
{
	uint8_t s = t->base.thread_state;

	if ((s & _THREAD_SUSPENDED) != 0U) {
		return eSuspended;
	}
	if ((s & (_THREAD_PENDING | _THREAD_SLEEPING)) != 0U) {
		return eBlocked;
	}
	return eReady;
}

static uint32_t eg_wait_bits(struct k_event *g, uint32_t bits, bool clear, bool all,
			     k_timeout_t timeout)
{
	if (all) {
		return clear ? k_event_wait_all_safe(g, bits, false, timeout)
			     : k_event_wait_all(g, bits, false, timeout);
	}
	return clear ? k_event_wait_safe(g, bits, false, timeout)
		     : k_event_wait(g, bits, false, timeout);
}

static uint32_t eg_get_bits(struct k_event *g)
{
	return k_event_test(g, ~EG_DELETED);
}

/* xEventGroupSync(): set bits, then wait for all of wait_bits, which are
 * cleared once the rendezvous completes. The set, the check and the start
 * of the wait must not be interleaved with another task's, so they run
 * with the scheduler locked (the tasks share one CPU, see demo.h).
 * Waiters that unblock consume the bits themselves (_safe); the task that
 * completes the rendezvous clears them if no one else was waiting.
 */
static uint32_t eg_sync(struct k_event *g, uint32_t set, uint32_t wait_bits,
			k_timeout_t timeout)
{
	uint32_t ret;

	k_sched_lock();
	/* The post below may wake the other tasks, which then consume the
	 * bits: decide from the group as it is before the post.
	 */
	ret = k_event_test(g, ~EG_DELETED) | set;
	k_event_post(g, set);
	if ((ret & wait_bits) == wait_bits) {
		k_event_clear(g, wait_bits);
	} else {
		ret = k_event_wait_all_safe(g, wait_bits, false, timeout);
		if (ret == 0) {
			/* Timed out: the group as it is, with this task's bit */
			ret = k_event_test(g, ~EG_DELETED);
		}
	}
	k_sched_unlock();
	return ret;
}

/* vEventGroupDelete() with tasks blocked on the group */
static void eg_delete(struct k_event *g)
{
	k_event_post(g, EG_DELETED);
}

static void prvSelectiveBitsTestSlaveFunction(void)
{
	uint32_t uxPendBits, uxReturned;

	uxPendBits = (k_current_get() == xSyncTask1) ? ebSELECTIVE_BITS_1 : ebSELECTIVE_BITS_2;

	for (;;) {
		k_thread_suspend(k_current_get());
		uxReturned = eg_wait_bits(&xEventGroup, uxPendBits | EG_DELETED, true, false,
					  K_FOREVER);
		if ((uxReturned & EG_DELETED) != 0U) {
			break;
		}
	}
}

static bool prvSelectiveBitsTestMasterFunction(void)
{
	bool xError = false;

	if (fr_state(xSyncTask1) != eSuspended) {
		xError = true;
	}
	if (fr_state(xSyncTask2) != eSuspended) {
		xError = true;
	}

	for (uint32_t uxBit = 0x01; uxBit < 0x100; uxBit <<= 1) {
		k_thread_resume(xSyncTask1);
		k_thread_resume(xSyncTask2);
		if (fr_state(xSyncTask1) != eBlocked) {
			xError = true;
		}
		if (fr_state(xSyncTask2) != eBlocked) {
			xError = true;
		}

		k_event_post(&xEventGroup, uxBit);

		if ((uxBit & ebSELECTIVE_BITS_1) == 0) {
			if (fr_state(xSyncTask1) != eBlocked) {
				xError = true;
			}
		} else if (fr_state(xSyncTask1) != eSuspended) {
			xError = true;
		}
		if ((uxBit & ebSELECTIVE_BITS_2) == 0) {
			if (fr_state(xSyncTask2) != eBlocked) {
				xError = true;
			}
		} else if (fr_state(xSyncTask2) != eSuspended) {
			xError = true;
		}
	}

	k_thread_resume(xSyncTask1);
	k_thread_resume(xSyncTask2);
	eg_delete(&xEventGroup);
	if (xError) {
		EG_ERROR();
	}
	return xError;
}

static void prvSyncTask(void *p1, void *p2, void *p3)
{
	uint32_t uxSynchronisationBit = POINTER_TO_UINT(p1);
	uint32_t uxReturned;

	prvSelectiveBitsTestSlaveFunction();

	for (;;) {
		k_thread_suspend(k_current_get());

		/* The test master has a lower priority: not complete yet */
		uxReturned = eg_sync(&xEventGroup, uxSynchronisationBit, ebALL_SYNC_BITS,
				     K_NO_WAIT);
		if ((uxReturned & ebALL_SYNC_BITS) == ebALL_SYNC_BITS) {
			EG_ERROR();
		}
		uxReturned = eg_sync(&xEventGroup, uxSynchronisationBit, ebALL_SYNC_BITS,
				     K_FOREVER);
		if ((uxReturned & ebALL_SYNC_BITS) != ebALL_SYNC_BITS) {
			EG_ERROR();
		}

		k_thread_suspend(k_current_get());

		/* This time the test master gets to the sync point first */
		uxReturned = eg_sync(&xEventGroup, uxSynchronisationBit, ebALL_SYNC_BITS,
				     K_FOREVER);
		if ((uxReturned & ebALL_SYNC_BITS) != ebALL_SYNC_BITS) {
			EG_ERROR();
		}

		/* Blocked while the group is deleted: returns 0 */
		uxReturned = eg_wait_bits(&xEventGroup, EG_DELETED, false, true, K_FOREVER);
		if (uxReturned != EG_DELETED) {
			EG_ERROR();
		}
	}
}

static void prvTestSlaveTask(void *p1, void *p2, void *p3)
{
	uint32_t uxReturned;
	bool xError = false;

	for (;;) {
		/* Part 1: counterpart of prvBitCombinationTestMasterFunction() */
		k_thread_suspend(k_current_get());

		/* FreeRTOS returns ebCOMBINED_BITS, the whole group */
		uxReturned = eg_wait_bits(&xEventGroup, ebBIT_1, true, true, K_FOREVER);
		if (uxReturned != ebBIT_1) {
			xError = true;
		}

		uxReturned = eg_wait_bits(&xEventGroup, ebCOMBINED_BITS, false, true, K_FOREVER);
		if ((uxReturned & ebCOMBINED_BITS) != ebCOMBINED_BITS) {
			xError = true;
		}

		k_thread_suspend(k_current_get());

		/* FreeRTOS returns ebALL_BITS, the whole group */
		uxReturned = eg_wait_bits(&xEventGroup, ebCOMBINED_BITS, true, true, K_FOREVER);
		if (uxReturned != ebCOMBINED_BITS) {
			xError = true;
		}

		/* Part 2: counterpart of prvPerformTaskSyncTests() */
		k_thread_suspend(k_current_get());

		uxReturned = eg_sync(&xEventGroup, ebWAIT_BIT_TASK_SYNC_BIT, ebALL_SYNC_BITS,
				     K_FOREVER);
		if ((uxReturned & ebALL_SYNC_BITS) != ebALL_SYNC_BITS) {
			xError = true;
		}
		if (eg_get_bits(&xEventGroup) != 0) {
			xError = true;
		}

		if (!xError) {
			ulTestSlaveCycles++;
		}

		k_thread_suspend(k_current_get());

		uxReturned = eg_sync(&xEventGroup, ebWAIT_BIT_TASK_SYNC_BIT, ebALL_SYNC_BITS,
				     K_FOREVER);
		if ((uxReturned & ebALL_SYNC_BITS) != ebALL_SYNC_BITS) {
			xError = true;
		}
		if (eg_get_bits(&xEventGroup) != 0) {
			xError = true;
		}

		uxReturned = eg_wait_bits(&xEventGroup, EG_DELETED, false, true, K_FOREVER);
		if (uxReturned != EG_DELETED) {
			xError = true;
		}

		if (!xError) {
			ulTestSlaveCycles++;
		} else {
			EG_ERROR();
		}
	}
}

static bool prvPerformTaskSyncTests(bool xError, k_tid_t xTestSlaveTaskHandle)
{
	uint32_t uxBits;

	if (fr_state(xTestSlaveTaskHandle) != eSuspended) {
		xError = true;
	}
	if (fr_state(xSyncTask1) != eSuspended) {
		xError = true;
	}
	if (fr_state(xSyncTask2) != eSuspended) {
		xError = true;
	}

	/* Sync on this task's own bit only */
	k_event_post(&xEventGroup, ebALL_SYNC_BITS & ~ebSET_BIT_TASK_SYNC_BIT);
	uxBits = eg_sync(&xEventGroup, ebSET_BIT_TASK_SYNC_BIT, ebSET_BIT_TASK_SYNC_BIT,
			 K_FOREVER);
	if ((uxBits & ebSET_BIT_TASK_SYNC_BIT) != ebSET_BIT_TASK_SYNC_BIT) {
		xError = true;
	}
	if (eg_get_bits(&xEventGroup) != (ebALL_SYNC_BITS & ~ebSET_BIT_TASK_SYNC_BIT)) {
		xError = true;
	}
	k_event_clear(&xEventGroup, ebALL_SYNC_BITS & ~ebSET_BIT_TASK_SYNC_BIT);
	if (eg_get_bits(&xEventGroup) != 0) {
		xError = true;
	}

	/* This task has the lowest priority: the others get there first */
	k_thread_resume(xTestSlaveTaskHandle);
	k_thread_resume(xSyncTask1);
	k_thread_resume(xSyncTask2);
	if (fr_state(xTestSlaveTaskHandle) != eBlocked) {
		xError = true;
	}
	if (fr_state(xSyncTask1) != eBlocked) {
		xError = true;
	}
	if (fr_state(xSyncTask2) != eBlocked) {
		xError = true;
	}

	uxBits = eg_sync(&xEventGroup, ebSET_BIT_TASK_SYNC_BIT, ebALL_SYNC_BITS, K_FOREVER);
	if ((uxBits & ebALL_SYNC_BITS) != ebALL_SYNC_BITS) {
		xError = true;
	}
	if (eg_get_bits(&xEventGroup) != 0) {
		xError = true;
	}
	if (fr_state(xTestSlaveTaskHandle) != eSuspended) {
		xError = true;
	}
	if (fr_state(xSyncTask1) != eSuspended) {
		xError = true;
	}
	if (fr_state(xSyncTask2) != eSuspended) {
		xError = true;
	}

	/* Now this task gets to the sync point first */
	k_thread_resume(xTestSlaveTaskHandle);
	k_thread_resume(xSyncTask1);
	k_thread_resume(xSyncTask2);
	if (fr_state(xTestSlaveTaskHandle) != eBlocked) {
		xError = true;
	}
	if (fr_state(xSyncTask1) != eBlocked) {
		xError = true;
	}
	if (fr_state(xSyncTask2) != eBlocked) {
		xError = true;
	}

	k_thread_priority_set(k_current_get(), FR_PRIO(ebWAIT_BIT_TASK_PRIORITY + 1));

	uxBits = eg_sync(&xEventGroup, ebSET_BIT_TASK_SYNC_BIT, ebALL_SYNC_BITS, K_FOREVER);
	if ((uxBits & ebALL_SYNC_BITS) != ebALL_SYNC_BITS) {
		xError = true;
	}
	if (eg_get_bits(&xEventGroup) != 0) {
		xError = true;
	}
	/* Unblocked, but with a lower priority than this task */
	if (fr_state(xTestSlaveTaskHandle) != eReady) {
		xError = true;
	}
	if (fr_state(xSyncTask1) != eReady) {
		xError = true;
	}
	if (fr_state(xSyncTask2) != eReady) {
		xError = true;
	}

	k_thread_priority_set(k_current_get(), FR_PRIO(ebSET_BIT_TASK_PRIORITY));

	/* They ran and blocked on the group, which will be deleted */
	if (fr_state(xTestSlaveTaskHandle) != eBlocked) {
		xError = true;
	}
	if (fr_state(xSyncTask1) != eBlocked) {
		xError = true;
	}
	if (fr_state(xSyncTask2) != eBlocked) {
		xError = true;
	}

	if (xError) {
		EG_ERROR();
	}
	return xError;
}

static bool prvBitCombinationTestMasterFunction(bool xError, k_tid_t xTestSlaveTaskHandle)
{
	uint32_t uxBits;

	k_thread_resume(xTestSlaveTaskHandle);
	if (fr_state(xTestSlaveTaskHandle) != eBlocked) {
		xError = true;
	}

	k_event_post(&xEventGroup, ebCOMBINED_BITS);
	uxBits = eg_wait_bits(&xEventGroup, ebALL_BITS, false, false, K_NO_WAIT);
	if (uxBits != (ebCOMBINED_BITS & ~ebBIT_1)) {
		xError = true;
	}
	if (fr_state(xTestSlaveTaskHandle) != eBlocked) {
		xError = true;
	}

	k_event_post(&xEventGroup, ebALL_BITS & ~ebBIT_1);
	uxBits = eg_wait_bits(&xEventGroup, ebALL_BITS, false, false, K_NO_WAIT);
	if (uxBits != (ebALL_BITS & ~ebBIT_1)) {
		xError = true;
	}
	if (fr_state(xTestSlaveTaskHandle) != eBlocked) {
		xError = true;
	}

	k_event_post(&xEventGroup, ebBIT_1);
	if (fr_state(xTestSlaveTaskHandle) != eSuspended) {
		xError = true;
	}

	/* xEventGroupSetBits(0) and xEventGroupClearBits() return the group */
	if (eg_get_bits(&xEventGroup) != ebALL_BITS) {
		xError = true;
	}
	k_sched_lock();
	if (eg_get_bits(&xEventGroup) != ebALL_BITS) {
		xError = true;
	}
	k_event_clear(&xEventGroup, ebBIT_1);
	k_sched_unlock();

	k_thread_resume(xTestSlaveTaskHandle);
	if (fr_state(xTestSlaveTaskHandle) != eBlocked) {
		xError = true;
	}

	k_event_post(&xEventGroup, ebBIT_1);
	if (fr_state(xTestSlaveTaskHandle) != eSuspended) {
		xError = true;
	}

	uxBits = eg_wait_bits(&xEventGroup, ebALL_BITS, false, false, K_NO_WAIT);
	if (uxBits != (ebALL_BITS & ~ebCOMBINED_BITS)) {
		xError = true;
	}
	k_sched_lock();
	if (eg_get_bits(&xEventGroup) != (ebALL_BITS & ~ebCOMBINED_BITS)) {
		xError = true;
	}
	k_event_clear(&xEventGroup, ebALL_BITS);
	k_sched_unlock();
	if (eg_get_bits(&xEventGroup) != 0x00) {
		xError = true;
	}

	if (xError) {
		EG_ERROR();
	}
	return xError;
}

static void prvTestMasterTask(void *p1, void *p2, void *p3)
{
	k_tid_t xTestSlaveTaskHandle = p1;
	bool xError;

	k_event_init(&xEventGroup);
	xError = prvSelectiveBitsTestMasterFunction();

	for (;;) {
		/* Recreate the event group */
		k_event_init(&xEventGroup);

		xError = prvBitCombinationTestMasterFunction(xError, xTestSlaveTaskHandle);
		xError = prvPerformTaskSyncTests(xError, xTestSlaveTaskHandle);

		eg_delete(&xEventGroup);

		/* The other tasks completed and suspended themselves */
		if (fr_state(xTestSlaveTaskHandle) != eSuspended) {
			xError = true;
		}
		if (fr_state(xSyncTask1) != eSuspended) {
			xError = true;
		}
		if (fr_state(xSyncTask2) != eSuspended) {
			xError = true;
		}

		if (!xError) {
			ulTestMasterCycles++;
		} else {
			EG_ERROR();
		}
	}
}

/* vPeriodicEventGroupsProcessing(), called from the tick hook */
static void periodic_event_groups(struct k_timer *timer)
{
	static int xCallCount;
	static bool xISRTestError;
	const int xSetBitCount = 100, xGetBitsCount = 200, xClearBitsCount = 300;
	const uint32_t uxBitsToSet = 0x12U;

	xCallCount++;

	if (xCallCount == xSetBitCount) {
		if (k_event_test(&xISREventGroup, ~0U) != 0x00) {
			xISRTestError = true;
		} else {
			k_event_post(&xISREventGroup, uxBitsToSet);
		}
	} else if (xCallCount == xGetBitsCount) {
		if (k_event_test(&xISREventGroup, ~0U) != uxBitsToSet) {
			xISRTestError = true;
		}
	} else if (xCallCount == xClearBitsCount) {
		k_event_clear(&xISREventGroup, uxBitsToSet);
		xCallCount = 0;
		if (!xISRTestError) {
			ulISRCycles++;
		} else {
			EG_ERROR();
		}
	}
}

static K_TIMER_DEFINE(tick_hook, periodic_event_groups, NULL);

void vStartEventGroupTasks(void)
{
	k_tid_t xTestSlaveTaskHandle;

	/* Created in the demo's order; all on CPU 0 on SMP (demo.h) */
	xTestSlaveTaskHandle = fr_task_create(prvTestSlaveTask, "WaitO", NULL,
					      ebWAIT_BIT_TASK_PRIORITY, true);
	xSyncTask1 = fr_task_create(prvSyncTask, "Rndv",
				    UINT_TO_POINTER(ebRENDEZVOUS_TASK_1_SYNC_BIT),
				    ebWAIT_BIT_TASK_PRIORITY, true);
	xSyncTask2 = fr_task_create(prvSyncTask, "Rndv",
				    UINT_TO_POINTER(ebRENDEZVOUS_TASK_2_SYNC_BIT),
				    ebWAIT_BIT_TASK_PRIORITY, true);
	/* The master is created after the slave in the demo; it starts last
	 * here so that the sync tasks it checks for already exist.
	 */
	fr_task_create(prvTestMasterTask, "SetB", xTestSlaveTaskHandle,
		       ebSET_BIT_TASK_PRIORITY, true);

	k_event_init(&xISREventGroup);
	k_timer_start(&tick_hook, K_TICKS(1), K_TICKS(1));
}

bool xAreEventGroupTasksStillRunning(void)
{
	static uint32_t ulPreviousWaitBitCycles, ulPreviousSetBitCycles, ulPreviousISRCycles;
	bool xStatus = true;

	if (ulPreviousSetBitCycles == ulTestMasterCycles) {
		xStatus = false;
	}
	ulPreviousSetBitCycles = ulTestMasterCycles;
	if (ulPreviousWaitBitCycles == ulTestSlaveCycles) {
		xStatus = false;
	}
	ulPreviousWaitBitCycles = ulTestSlaveCycles;
	if (ulPreviousISRCycles == ulISRCycles) {
		xStatus = false;
	}
	ulPreviousISRCycles = ulISRCycles;

	if (eg_error_line != 0) {
		printk("EventGroups: first error at line %d\n", eg_error_line);
		xStatus = false;
	}
	return xStatus;
}
```

## src/queues.c
```c
/*
 * SPDX-License-Identifier: Apache-2.0
 *
 * PollQ.c and BlockQ.c. FreeRTOS queues become k_msgq.
 */

#include "demo.h"

/* ---- PollQ.c ---- */

#define pollqQUEUE_SIZE        10
#define pollqPRODUCER_DELAY    200
#define pollqCONSUMER_DELAY    (pollqPRODUCER_DELAY - 20)
#define pollqVALUES_TO_PRODUCE 3
#define pollqINITIAL_VALUE     0

static struct k_msgq xPolledQueue;
static char __aligned(4) polled_buf[pollqQUEUE_SIZE * sizeof(uint16_t)];
static volatile int xPollingConsumerCount = pollqINITIAL_VALUE;
static volatile int xPollingProducerCount = pollqINITIAL_VALUE;

static void vPolledQueueProducer(void *p1, void *p2, void *p3)
{
	uint16_t usValue = 0;
	bool xError = false;

	for (;;) {
		for (int xLoop = 0; xLoop < pollqVALUES_TO_PRODUCE; xLoop++) {
			if (k_msgq_put(&xPolledQueue, &usValue, K_NO_WAIT) != 0) {
				xError = true;
			} else {
				if (!xError) {
					xPollingProducerCount++;
				}
				usValue++;
			}
		}
		k_sleep(K_TICKS(pollqPRODUCER_DELAY));
	}
}

static void vPolledQueueConsumer(void *p1, void *p2, void *p3)
{
	uint16_t usData, usExpectedValue = 0;
	bool xError = false;

	for (;;) {
		while (k_msgq_num_used_get(&xPolledQueue) != 0U) {
			if (k_msgq_get(&xPolledQueue, &usData, K_NO_WAIT) == 0) {
				if (usData != usExpectedValue) {
					xError = true;
					usExpectedValue = usData;
				} else if (!xError) {
					xPollingConsumerCount++;
				}
				usExpectedValue++;
			}
		}
		k_sleep(K_TICKS(pollqCONSUMER_DELAY));
	}
}

void vStartPolledQueueTasks(int uxPriority)
{
	k_msgq_init(&xPolledQueue, polled_buf, sizeof(uint16_t), pollqQUEUE_SIZE);
	fr_task_create(vPolledQueueConsumer, "QConsNB", NULL, uxPriority, false);
	fr_task_create(vPolledQueueProducer, "QProdNB", NULL, uxPriority, false);
}

bool xArePollingQueuesStillRunning(void)
{
	bool xReturn = (xPollingConsumerCount != pollqINITIAL_VALUE) &&
		       (xPollingProducerCount != pollqINITIAL_VALUE);

	xPollingConsumerCount = pollqINITIAL_VALUE;
	xPollingProducerCount = pollqINITIAL_VALUE;
	return xReturn;
}

/* ---- BlockQ.c ---- */

#define blckqNUM_TASK_SETS 3
#define blckqSHORT_DELAY   5

struct xBlockingQueueParameters {
	struct k_msgq *xQueue;
	k_timeout_t xBlockTime;
	bool xDontBlock;
	volatile short *psCheckVariable;
};

static volatile short sBlockingConsumerCount[blckqNUM_TASK_SETS];
static volatile short sBlockingProducerCount[blckqNUM_TASK_SETS];
static struct k_msgq bq[3];
static char __aligned(4) bq_buf1[1 * sizeof(uint16_t)];
static char __aligned(4) bq_buf3[1 * sizeof(uint16_t)];
static char __aligned(4) bq_buf5[5 * sizeof(uint16_t)];
static struct xBlockingQueueParameters bqp[6];

static void vBlockingQueueProducer(void *p1, void *p2, void *p3)
{
	struct xBlockingQueueParameters *pxQueueParameters = p1;
	uint16_t usValue = 0;
	bool sErrorEverOccurred = false;

	for (;;) {
		if (k_msgq_put(pxQueueParameters->xQueue, &usValue,
			       pxQueueParameters->xBlockTime) != 0) {
			sErrorEverOccurred = true;
		} else {
			if (!sErrorEverOccurred) {
				(*pxQueueParameters->psCheckVariable)++;
			}
			++usValue;
			/* configNUMBER_OF_CORES > 1 */
			if (IS_ENABLED(CONFIG_SMP) && pxQueueParameters->xDontBlock) {
				k_sleep(K_TICKS(blckqSHORT_DELAY));
			} else if (pxQueueParameters->xDontBlock) {
				/* The demo's configUSE_PREEMPTION == 0 path. A
				 * polling task is preempted by its blocking peer
				 * on every item, and Zephyr restarts the time
				 * slice at every switch-in, so without this it
				 * never yields to other idle-priority tasks.
				 */
				k_yield();
			}
		}
	}
}

static void vBlockingQueueConsumer(void *p1, void *p2, void *p3)
{
	struct xBlockingQueueParameters *pxQueueParameters = p1;
	uint16_t usData, usExpectedValue = 0;
	bool sErrorEverOccurred = false;

	for (;;) {
		if (k_msgq_get(pxQueueParameters->xQueue, &usData,
			       pxQueueParameters->xBlockTime) == 0) {
			if (usData != usExpectedValue) {
				usExpectedValue = usData;
				sErrorEverOccurred = true;
			} else {
				if (!sErrorEverOccurred) {
					(*pxQueueParameters->psCheckVariable)++;
				}
				++usExpectedValue;
			}
			if (IS_ENABLED(CONFIG_SMP) && pxQueueParameters->xDontBlock) {
				k_sleep(K_TICKS(blckqSHORT_DELAY));
			} else if (pxQueueParameters->xDontBlock) {
				k_yield();	/* as in the producer */
			}
		}
	}
}

static void bq_param(int i, struct k_msgq *q, bool block, volatile short *check)
{
	bqp[i].xQueue = q;
	bqp[i].xDontBlock = !block;
	bqp[i].xBlockTime = block ? K_TICKS(1000) : K_NO_WAIT;
	bqp[i].psCheckVariable = check;
}

void vStartBlockingQueueTasks(int uxPriority)
{
	k_msgq_init(&bq[0], bq_buf1, sizeof(uint16_t), 1);
	k_msgq_init(&bq[1], bq_buf3, sizeof(uint16_t), 1);
	k_msgq_init(&bq[2], bq_buf5, sizeof(uint16_t), 5);

	/* Set 1: blocking consumer at uxPriority, polling producer at idle. */
	bq_param(0, &bq[0], true, &sBlockingConsumerCount[0]);
	bq_param(1, &bq[0], false, &sBlockingProducerCount[0]);
	fr_task_create(vBlockingQueueConsumer, "QConsB1", &bqp[0], uxPriority, false);
	fr_task_create(vBlockingQueueProducer, "QProdB2", &bqp[1], tskIDLE_PRIORITY, false);

	/* Set 2: polling consumer at idle, blocking producer at uxPriority. */
	bq_param(2, &bq[1], false, &sBlockingProducerCount[1]);
	bq_param(3, &bq[1], true, &sBlockingConsumerCount[1]);
	fr_task_create(vBlockingQueueConsumer, "QConsB3", &bqp[2], tskIDLE_PRIORITY, false);
	fr_task_create(vBlockingQueueProducer, "QProdB4", &bqp[3], uxPriority, false);

	/* Set 3: both blocking, both at idle. */
	bq_param(4, &bq[2], true, &sBlockingProducerCount[2]);
	bq_param(5, &bq[2], true, &sBlockingConsumerCount[2]);
	fr_task_create(vBlockingQueueProducer, "QProdB5", &bqp[4], tskIDLE_PRIORITY, false);
	fr_task_create(vBlockingQueueConsumer, "QConsB6", &bqp[5], tskIDLE_PRIORITY, false);
}

bool xAreBlockingQueuesStillRunning(void)
{
	static short sLastBlockingConsumerCount[blckqNUM_TASK_SETS];
	static short sLastBlockingProducerCount[blckqNUM_TASK_SETS];
	bool xReturn = true;

	for (int xTasks = 0; xTasks < blckqNUM_TASK_SETS; xTasks++) {
		if (sBlockingConsumerCount[xTasks] == sLastBlockingConsumerCount[xTasks]) {
			xReturn = false;
		}
		sLastBlockingConsumerCount[xTasks] = sBlockingConsumerCount[xTasks];
		if (sBlockingProducerCount[xTasks] == sLastBlockingProducerCount[xTasks]) {
			xReturn = false;
		}
		sLastBlockingProducerCount[xTasks] = sBlockingProducerCount[xTasks];
	}
	return xReturn;
}
```

## src/sync.c
```c
/*
 * SPDX-License-Identifier: Apache-2.0
 *
 * semtest.c, countsem.c, recmutex.c and integer.c. Binary and counting
 * semaphores become k_sem, the recursive mutex a k_mutex (recursive, with
 * priority inheritance, like FreeRTOS mutexes), critical sections
 * irq_lock().
 */

#include "demo.h"

/* ---- semtest.c ---- */

#define semtstBLOCKING_EXPECTED_VALUE     0xfffU
#define semtstNON_BLOCKING_EXPECTED_VALUE 0xffU
#define semtstNUM_TASKS                   4
#define semtstDELAY_FACTOR                10

struct xSemaphoreParameters {
	struct k_sem xSemaphore;
	volatile uint32_t ulSharedVariable;
	uint32_t xBlockTime;
};

static struct xSemaphoreParameters sem_params[2];
static volatile short sCheckVariables[semtstNUM_TASKS];
static volatile short sNextCheckVariable;

static void prvSemaphoreTest(void *p1, void *p2, void *p3)
{
	struct xSemaphoreParameters *pxParameters = p1;
	volatile uint32_t *pulSharedVariable = &pxParameters->ulSharedVariable;
	uint32_t ulExpectedValue;
	bool sError = false;
	short sCheckVariableToUse;
	unsigned int key = irq_lock();

	sCheckVariableToUse = sNextCheckVariable;
	sNextCheckVariable++;
	irq_unlock(key);

	ulExpectedValue = (pxParameters->xBlockTime > 0) ? semtstBLOCKING_EXPECTED_VALUE
							  : semtstNON_BLOCKING_EXPECTED_VALUE;

	for (;;) {
		if (k_sem_take(&pxParameters->xSemaphore,
			       K_TICKS(pxParameters->xBlockTime)) == 0) {
			if (*pulSharedVariable != ulExpectedValue) {
				sError = true;
			}
			for (uint32_t ulCounter = 0; ulCounter <= ulExpectedValue; ulCounter++) {
				*pulSharedVariable = ulCounter;
				if (*pulSharedVariable != ulCounter) {
					sError = true;
				}
			}
			/* xSemaphoreGive() of a binary semaphore that is
			 * already given fails; k_sem_give() cannot report it,
			 * so check the count before.
			 */
			if (k_sem_count_get(&pxParameters->xSemaphore) != 0U) {
				sError = true;
			}
			k_sem_give(&pxParameters->xSemaphore);
			if (!sError && (sCheckVariableToUse < semtstNUM_TASKS)) {
				sCheckVariables[sCheckVariableToUse]++;
			}
			if (pxParameters->xBlockTime != 0) {
				k_sleep(K_TICKS(pxParameters->xBlockTime * semtstDELAY_FACTOR));
			}
		} else if (pxParameters->xBlockTime == 0) {
			k_yield();
		}
	}
}

void vStartSemaphoreTasks(int uxPriority)
{
	k_sem_init(&sem_params[0].xSemaphore, 1, 1);
	sem_params[0].ulSharedVariable = semtstNON_BLOCKING_EXPECTED_VALUE;
	sem_params[0].xBlockTime = 0;
	fr_task_create(prvSemaphoreTest, "PolSEM1", &sem_params[0], tskIDLE_PRIORITY, false);
	fr_task_create(prvSemaphoreTest, "PolSEM2", &sem_params[0], tskIDLE_PRIORITY, false);

	k_sem_init(&sem_params[1].xSemaphore, 1, 1);
	sem_params[1].ulSharedVariable = semtstBLOCKING_EXPECTED_VALUE;
	sem_params[1].xBlockTime = 100;	/* xBlockTime / portTICK_PERIOD_MS */
	fr_task_create(prvSemaphoreTest, "BlkSEM1", &sem_params[1], uxPriority, false);
	fr_task_create(prvSemaphoreTest, "BlkSEM2", &sem_params[1], uxPriority, false);
}

bool xAreSemaphoreTasksStillRunning(void)
{
	static short sLastCheckVariables[semtstNUM_TASKS];
	bool xReturn = true;

	for (int xTask = 0; xTask < semtstNUM_TASKS; xTask++) {
		if (sLastCheckVariables[xTask] == sCheckVariables[xTask]) {
			xReturn = false;
		}
		sLastCheckVariables[xTask] = sCheckVariables[xTask];
	}
	return xReturn;
}

/* ---- countsem.c ---- */

#define countMAX_COUNT_VALUE   200
#define countSTART_AT_MAX_COUNT 0xaa
#define countSTART_AT_ZERO      0x55

struct xCountSemStruct {
	struct k_sem xSemaphore;
	unsigned int uxExpectedStartCount;
	volatile unsigned int uxLoopCounter;
};

static volatile bool xCountErrorDetected;
static struct xCountSemStruct xParameters[2];

/* xSemaphoreGive() on a full counting semaphore fails; k_sem_give() at the
 * limit silently does nothing, so report it from the count.
 */
static bool sem_give_ok(struct k_sem *s)
{
	unsigned int before = k_sem_count_get(s);

	k_sem_give(s);
	return k_sem_count_get(s) != before;
}

static void prvIncrementSemaphoreCount(struct k_sem *xSemaphore,
				       volatile unsigned int *puxLoopCounter)
{
	if (k_sem_take(xSemaphore, K_NO_WAIT) == 0) {
		xCountErrorDetected = true;
	}
	for (int ux = 0; ux < countMAX_COUNT_VALUE; ux++) {
		if (!sem_give_ok(xSemaphore)) {
			xCountErrorDetected = true;
		}
		(*puxLoopCounter)++;
	}
	if (sem_give_ok(xSemaphore)) {
		xCountErrorDetected = true;
	}
}

static void prvDecrementSemaphoreCount(struct k_sem *xSemaphore,
				       volatile unsigned int *puxLoopCounter)
{
	if (sem_give_ok(xSemaphore)) {
		xCountErrorDetected = true;
	}
	for (int ux = 0; ux < countMAX_COUNT_VALUE; ux++) {
		if (k_sem_take(xSemaphore, K_NO_WAIT) != 0) {
			xCountErrorDetected = true;
		}
		(*puxLoopCounter)++;
	}
	if (k_sem_take(xSemaphore, K_NO_WAIT) == 0) {
		xCountErrorDetected = true;
	}
}

static void prvCountingSemaphoreTask(void *p1, void *p2, void *p3)
{
	struct xCountSemStruct *pxParameter = p1;

	if (pxParameter->uxExpectedStartCount == countSTART_AT_MAX_COUNT) {
		prvDecrementSemaphoreCount(&pxParameter->xSemaphore, &pxParameter->uxLoopCounter);
	}
	if (k_sem_take(&pxParameter->xSemaphore, K_NO_WAIT) == 0) {
		xCountErrorDetected = true;
	}
	for (;;) {
		prvIncrementSemaphoreCount(&pxParameter->xSemaphore, &pxParameter->uxLoopCounter);
		prvDecrementSemaphoreCount(&pxParameter->xSemaphore, &pxParameter->uxLoopCounter);
	}
}

void vStartCountingSemaphoreTasks(void)
{
	k_sem_init(&xParameters[0].xSemaphore, countMAX_COUNT_VALUE, countMAX_COUNT_VALUE);
	xParameters[0].uxExpectedStartCount = countSTART_AT_MAX_COUNT;
	k_sem_init(&xParameters[1].xSemaphore, 0, countMAX_COUNT_VALUE);
	xParameters[1].uxExpectedStartCount = 0;
	fr_task_create(prvCountingSemaphoreTask, "CNT1", &xParameters[0], tskIDLE_PRIORITY, false);
	fr_task_create(prvCountingSemaphoreTask, "CNT2", &xParameters[1], tskIDLE_PRIORITY, false);
}

bool xAreCountingSemaphoreTasksStillRunning(void)
{
	static unsigned int uxLastCount0, uxLastCount1;
	bool xReturn = !xCountErrorDetected;

	if (uxLastCount0 == xParameters[0].uxLoopCounter) {
		xReturn = false;
	} else {
		uxLastCount0 = xParameters[0].uxLoopCounter;
	}
	if (uxLastCount1 == xParameters[1].uxLoopCounter) {
		xReturn = false;
	} else {
		uxLastCount1 = xParameters[1].uxLoopCounter;
	}
	return xReturn;
}

/* ---- recmutex.c ---- */

#define recmuCONTROLLING_TASK_PRIORITY (tskIDLE_PRIORITY + 2)
#define recmuBLOCKING_TASK_PRIORITY    (tskIDLE_PRIORITY + 1)
#define recmuPOLLING_TASK_PRIORITY     (tskIDLE_PRIORITY + 0)
#define recmuMAX_COUNT                 10
#define recmuSHORT_DELAY               20
#define recmu15ms_DELAY                15

static struct k_mutex xMutex;
static volatile int xRecError;
static volatile bool xControllingIsSuspended, xBlockingIsSuspended;
static volatile unsigned int uxControllingCycles, uxBlockingCycles, uxPollingCycles;
static k_tid_t xControllingTaskHandle, xBlockingTaskHandle;

static void prvRecursiveMutexControllingTask(void *p1, void *p2, void *p3)
{
	for (;;) {
		/* Giving a mutex we do not hold must fail. */
		if (k_mutex_unlock(&xMutex) == 0) {
			xRecError = __LINE__;
		}
		for (int ux = 0; ux < recmuMAX_COUNT; ux++) {
			if (k_mutex_lock(&xMutex, K_TICKS(recmu15ms_DELAY)) != 0) {
				xRecError = __LINE__;
			}
			k_sleep(K_TICKS(recmuSHORT_DELAY));
		}
		for (int ux = 0; ux < recmuMAX_COUNT; ux++) {
			k_sleep(K_TICKS(recmuSHORT_DELAY));
			if (k_mutex_unlock(&xMutex) != 0) {
				xRecError = __LINE__;
			}
		}
		if (k_mutex_unlock(&xMutex) == 0) {
			xRecError = __LINE__;
		}
		uxControllingCycles++;
		xControllingIsSuspended = true;
		k_thread_suspend(k_current_get());
		xControllingIsSuspended = false;
	}
}

static void prvRecursiveMutexBlockingTask(void *p1, void *p2, void *p3)
{
	for (;;) {
		/* portMAX_DELAY - 1: a long but finite wait */
		if (k_mutex_lock(&xMutex, K_TICKS(UINT32_MAX - 1)) == 0) {
			if (!xControllingIsSuspended) {
				xRecError = __LINE__;
			} else {
				if (k_mutex_unlock(&xMutex) != 0) {
					xRecError = __LINE__;
				}
				xBlockingIsSuspended = true;
				k_thread_suspend(k_current_get());
				xBlockingIsSuspended = false;
			}
		} else {
			xRecError = __LINE__;
		}
		if (uxControllingCycles != (uxBlockingCycles + 1)) {
			xRecError = __LINE__;
		}
		uxBlockingCycles++;
	}
}

static void prvRecursiveMutexPollingTask(void *p1, void *p2, void *p3)
{
	for (;;) {
		if (k_mutex_lock(&xMutex, K_NO_WAIT) == 0) {
			FR_ASSERT(xRecError, fr_is_suspended(xControllingTaskHandle));
			FR_ASSERT(xRecError, fr_is_suspended(xBlockingTaskHandle));
			if (!xBlockingIsSuspended || !xControllingIsSuspended) {
				xRecError = __LINE__;
			} else {
				uxPollingCycles++;
				k_thread_resume(xBlockingTaskHandle);
				k_thread_resume(xControllingTaskHandle);
				if (xBlockingIsSuspended || xControllingIsSuspended) {
					xRecError = __LINE__;
				}
				/* Both now wait on the mutex, so we inherit the
				 * controlling task's priority.
				 */
				FR_ASSERT(xRecError, k_thread_priority_get(k_current_get()) ==
						     FR_PRIO(recmuCONTROLLING_TASK_PRIORITY));
				if (k_mutex_unlock(&xMutex) != 0) {
					xRecError = __LINE__;
				}
				FR_ASSERT(xRecError, k_thread_priority_get(k_current_get()) ==
						     FR_PRIO(recmuPOLLING_TASK_PRIORITY));
			}
		}
	}
}

void vStartRecursiveMutexTasks(void)
{
	k_mutex_init(&xMutex);
	xControllingTaskHandle = fr_task_create(prvRecursiveMutexControllingTask, "Rec1", NULL,
						recmuCONTROLLING_TASK_PRIORITY, true);
	xBlockingTaskHandle = fr_task_create(prvRecursiveMutexBlockingTask, "Rec2", NULL,
					     recmuBLOCKING_TASK_PRIORITY, true);
	fr_task_create(prvRecursiveMutexPollingTask, "Rec3", NULL, recmuPOLLING_TASK_PRIORITY,
		       true);
}

bool xAreRecursiveMutexTasksStillRunning(void)
{
	static unsigned int uxLastControllingCycles, uxLastBlockingCycles, uxLastPollingCycles;

	if (uxLastControllingCycles == uxControllingCycles) {
		xRecError = __LINE__;
	} else {
		uxLastControllingCycles = uxControllingCycles;
	}
	if (uxLastBlockingCycles == uxBlockingCycles) {
		xRecError = __LINE__;
	} else {
		uxLastBlockingCycles = uxBlockingCycles;
	}
	if (uxLastPollingCycles == uxPollingCycles) {
		xRecError = __LINE__;
	} else {
		uxLastPollingCycles = uxPollingCycles;
	}
	if (xRecError != 0) {
		printk("recmutex error at line %d\n", xRecError);
	}
	return xRecError == 0;
}

/* ---- integer.c ---- */

#define intgCONST1          123L
#define intgCONST2          234567L
#define intgCONST3          (-3L)
#define intgCONST4          7L
#define intgEXPECTED_ANSWER (((intgCONST1 + intgCONST2) * intgCONST3) / intgCONST4)
#define intgNUMBER_OF_TASKS 1

static volatile bool xTaskCheck[intgNUMBER_OF_TASKS];

static void vCompeteingIntMathTask(void *p1, void *p2, void *p3)
{
	volatile bool *pxTaskHasExecuted = p1;
	volatile long lValue;
	bool sError = false;

	for (;;) {
		lValue = intgCONST1;
		lValue += intgCONST2;
		lValue *= intgCONST3;
		lValue /= intgCONST4;
		if (lValue != intgEXPECTED_ANSWER) {
			sError = true;
		}
		if (!sError) {
			unsigned int key = irq_lock();

			*pxTaskHasExecuted = true;
			irq_unlock(key);
		}
	}
}

void vStartIntegerMathTasks(int uxPriority)
{
	for (int sTask = 0; sTask < intgNUMBER_OF_TASKS; sTask++) {
		fr_task_create(vCompeteingIntMathTask, "IntMath", (void *)&xTaskCheck[sTask],
			       uxPriority, false);
	}
}

bool xAreIntegerMathsTaskStillRunning(void)
{
	bool xReturn = true;

	for (int sTask = 0; sTask < intgNUMBER_OF_TASKS; sTask++) {
		if (!xTaskCheck[sTask]) {
			xReturn = false;
		}
		xTaskCheck[sTask] = false;
	}
	return xReturn;
}
```
