## CMakeLists.txt
```
# SPDX-License-Identifier: Apache-2.0

cmake_minimum_required(VERSION 3.20.0)
find_package(Zephyr REQUIRED HINTS $ENV{ZEPHYR_BASE})
project(other_os_events)

target_sources(app PRIVATE src/main.c src/rtthread_event.c src/nuttx_nxevent.c
			    src/riot_thread_flags.c)
```

## prj.conf
```kconfig
CONFIG_ZTEST=y
CONFIG_ZTEST_STACK_SIZE=2048
CONFIG_EVENTS=y
CONFIG_ASSERT=y
CONFIG_SPIN_VALIDATE=y
```

## src/main.c
```c
/*
 * SPDX-License-Identifier: Apache-2.0
 *
 * Event tests of other RTOSes, ported to k_event (see README.rst):
 * - RT-Thread src/utest/event_tc.c
 * - NuttX apps/testing/ostest/nxevent.c
 * - RIOT tests/core/thread_flags, tests/core/thread_flags_group
 *
 * The originals run on one CPU; on SMP the other CPUs are held during each
 * test, as in the ThreadX port.
 */

#include <zephyr/ztest.h>

ZTEST_SUITE(other_os_events, NULL, NULL, ztest_simple_1cpu_before,
	    ztest_simple_1cpu_after, NULL);
```

## src/nuttx_nxevent.c
```c
/*
 * SPDX-License-Identifier: Apache-2.0
 *
 * Port of NuttX apps/testing/ostest/nxevent.c.
 *
 * NuttX -> Zephyr (NuttX sched/event):
 * - wait mask 0 means any event                   mask ~0
 * - nxevent_post(e, 0, ...) posts every event     k_event_post(~0)
 * - nxevent_post(..., 0)                          k_event_post()
 * - nxevent_post(..., NXEVENT_POST_SET)           k_event_set()
 * - nxevent_wait(..., 0): any, clear the matched  k_event_wait_safe()
 * - NXEVENT_WAIT_ALL                              k_event_wait_all_safe()
 * - NXEVENT_WAIT_NOCLEAR                          k_event_wait*() (not _safe)
 * - nxevent_trywait(), nxevent_tickwait(d)        K_NO_WAIT, K_TICKS(d)
 * - nxevent_clear(), nxevent_getmask()            k_event_clear(), k_event_test(~0)
 * Both return the matched events (all requested ones for WAIT_ALL).
 * The test's threads run at the default priority, as ostest itself does
 * by default, so they get the same priority as the ztest thread here;
 * nxevent_yield() is usleep(1).
 */

#include <zephyr/ztest.h>
#include "port.h"

#define NX_ANY      0x0
#define NX_ALL      0x1
#define NX_NOCLEAR  0x2
#define NX_POST_SET 0x1
#define STACK_SIZE  (1024 + CONFIG_TEST_EXTRA_STACK_SIZE)

static struct k_event event;
static K_THREAD_STACK_ARRAY_DEFINE(stacks, 2, STACK_SIZE);
static struct k_thread threads[2];
static volatile int nx_error_line;

static uint32_t nx_tickwait(struct k_event *ev, uint32_t events, int eflags,
			    k_timeout_t timeout)
{
	uint32_t m = (events == 0U) ? ~0U : events;

	if ((eflags & NX_ALL) != 0) {
		return (eflags & NX_NOCLEAR) ? k_event_wait_all(ev, m, false, timeout)
					     : k_event_wait_all_safe(ev, m, false, timeout);
	}
	return (eflags & NX_NOCLEAR) ? k_event_wait(ev, m, false, timeout)
				     : k_event_wait_safe(ev, m, false, timeout);
}

#define nx_wait(ev, m, f)    nx_tickwait(ev, m, f, K_FOREVER)
#define nx_trywait(ev, m, f) nx_tickwait(ev, m, f, K_NO_WAIT)

static void nx_post(struct k_event *ev, uint32_t events, int eflags)
{
	uint32_t e = (events == 0U) ? ~0U : events;

	if ((eflags & NX_POST_SET) != 0) {
		k_event_set(ev, e);
	} else {
		k_event_post(ev, e);
	}
}

static void nx_yield(void)
{
	k_usleep(1);
}

/* NXEVENT_TEST() asserts; keep the first failing line */
#define NXEVENT_TEST(expr, value)                                            \
	do {                                                                 \
		uint32_t r_ = (expr);                                        \
		if ((r_ != (uint32_t)(value)) && (nx_error_line == 0)) {     \
			printk("nxevent line %d: 0x%x != 0x%x\n", __LINE__, r_, \
			       (uint32_t)(value));                           \
			nx_error_line = __LINE__;                            \
		}                                                            \
	} while (false)

static void nxevent_test_rule1(struct k_event *ev)
{
	nx_post(ev, 0xf, 0);                            /* 2.1 */
	nx_yield();                                     /* 2.2 */
	NXEVENT_TEST(nx_wait(ev, 0, 0), ~0U);
	nx_yield();                                     /* 2.3 */
	nx_post(ev, ~0U, 0);
	nx_yield();                                     /* 2.4 */
	NXEVENT_TEST(nx_wait(ev, ~0U, 0), ~0U);
	nx_yield();                                     /* 2.5 */
	nx_post(ev, BIT(0), 0);
	nx_post(ev, BIT(1), 0);
	nx_post(ev, BIT(2), 0);
	nx_post(ev, BIT(3), 0);
	nx_yield();                                     /* 2.6 */
	nx_post(ev, 0xaaaaaaaa, 0);
	nx_yield();
	nx_yield();                                     /* 2.7 */
	nx_post(ev, 0, 0);
	nx_yield();
	nx_yield();
}

static void nxevent_test_rule0(struct k_event *ev)
{
	NXEVENT_TEST(nx_wait(ev, 0, 0), 0xf);           /* 2.1 */
	nx_yield();                                     /* 2.2 */
	nx_post(ev, ~0U, 0);
	nx_yield();                                     /* 2.3 */
	NXEVENT_TEST(nx_wait(ev, ~0U, 0), ~0U);
	nx_yield();                                     /* 2.4 */
	nx_post(ev, 0, 0);
	nx_yield();                                     /* 2.5 */
	NXEVENT_TEST(nx_wait(ev, 0xf, NX_ALL), 0xf);
	nx_yield();                                     /* 2.6 */
	NXEVENT_TEST(nx_wait(ev, 0xaaaaaaaa, 0), 0xaaaaaaaa);
	nx_yield();
	NXEVENT_TEST(nx_wait(ev, 0x1, 0), 0x1);         /* 2.7 */
	nx_yield();
	NXEVENT_TEST(nx_wait(ev, 0x2, 0), 0x2);
	NXEVENT_TEST(nx_wait(ev, 0, 0), ~(0x1U | 0x2U));
	nx_yield();
}

static void nxevent_thread(void *p1, void *p2, void *p3)
{
	struct k_event *ev = p1;

	nxevent_test_rule1(ev);
	nxevent_test_rule0(ev);
	nxevent_test_rule1(ev);
	nxevent_test_rule0(ev);
	nxevent_test_rule1(ev);
}

static void nxevent_thread1(void *p1, void *p2, void *p3)
{
	struct k_event *ev = p1;

	NXEVENT_TEST(nx_wait(ev, 0xf, 0), 0xf);         /* 3.1 */
	nx_yield();                                     /* 3.2 */
	nx_post(ev, 0xf, 0);
}

static void nxevent_thread2(void *p1, void *p2, void *p3)
{
	struct k_event *ev = p1;

	NXEVENT_TEST(nx_wait(ev, 0xf0, 0), 0xf0);       /* 3.1 */
	nx_yield();                                     /* 3.2 */
	nx_post(ev, 0xf0, 0);
}

static void start(int i, k_thread_entry_t entry)
{
	k_thread_create(&threads[i], stacks[i], STACK_SIZE, entry, &event, NULL, NULL,
			k_thread_priority_get(k_current_get()), 0, K_NO_WAIT);
}

static void join(int i)
{
	if (k_thread_join(&threads[i], K_SECONDS(5)) != 0) {
		k_thread_abort(&threads[i]);
		if (nx_error_line == 0) {
			nx_error_line = -1;
		}
	}
}

ZTEST(other_os_events, test_nuttx_nxevent)
{
	nx_error_line = 0;
	k_thread_priority_set(k_current_get(), PORT_MAIN_PRIO);

	/* NXEVENT_INITIALIZER(event, ~0) */
	k_event_init(&event);
	k_event_set(&event, ~0U);

	/* 1. Task local test */
	NXEVENT_TEST(nx_wait(&event, 0, 0), ~0U);       /* 1.1 */
	k_event_init(&event);                           /* 1.2 */
	k_event_set(&event, ~0U);
	NXEVENT_TEST(nx_wait(&event, ~0U, 0), ~0U);
	nx_post(&event, ~0U, 0);                        /* 1.3 */
	NXEVENT_TEST(nx_wait(&event, 0, 0), ~0U);
	nx_post(&event, ~0U, 0);                        /* 1.4 */
	NXEVENT_TEST(nx_wait(&event, ~0U, 0), ~0U);
	nx_post(&event, BIT(0), 0);                     /* 1.5 */
	nx_post(&event, BIT(1), 0);
	nx_post(&event, BIT(2), 0);
	nx_post(&event, BIT(3), 0);
	NXEVENT_TEST(nx_tickwait(&event, ~0U, NX_ALL, K_NO_WAIT), 0);
	NXEVENT_TEST(nx_trywait(&event, 0xf, 0), 0xf);  /* 1.6 */
	nx_post(&event, BIT(0), 0);
	nx_post(&event, BIT(1), 0);
	nx_post(&event, BIT(2), 0);
	nx_post(&event, BIT(3), 0);
	NXEVENT_TEST(nx_wait(&event, 0xf, 0), 0xf);     /* 1.7 */

	/* 2. Task notify test */
	start(0, nxevent_thread);
	nxevent_test_rule0(&event);
	nxevent_test_rule1(&event);
	nxevent_test_rule0(&event);
	nxevent_test_rule1(&event);
	nxevent_test_rule0(&event);
	join(0);

	/* 3. Multi task notify test */
	k_event_set(&event, 0);                         /* event.events = 0 */
	start(0, nxevent_thread1);
	start(1, nxevent_thread2);
	nx_yield();                                     /* 3.1 */
	nx_post(&event, 0xff, 0);
	nx_yield();
	NXEVENT_TEST(nx_wait(&event, 0xff, NX_ALL), 0xff); /* 3.2 */
	join(0);
	join(1);

	/* 4. Event clear test */
	nx_post(&event, 0xff, NX_POST_SET);
	k_event_clear(&event, 0);                       /* 4.1 */
	NXEVENT_TEST(nx_wait(&event, 0xf, NX_NOCLEAR), 0xf);
	NXEVENT_TEST(nx_trywait(&event, 0xf, NX_NOCLEAR), 0xf);
	k_event_clear(&event, 0xf);                     /* 4.2 */
	NXEVENT_TEST(nx_trywait(&event, 0xf, NX_NOCLEAR), 0);
	k_event_clear(&event, 0);                       /* 4.3 */
	NXEVENT_TEST(nx_wait(&event, 0xf0, NX_NOCLEAR), 0xf0);
	NXEVENT_TEST(nx_trywait(&event, 0xf0, NX_NOCLEAR), 0xf0);
	k_event_clear(&event, 0xf0);                    /* 4.4 */
	NXEVENT_TEST(nx_trywait(&event, 0xf0, NX_NOCLEAR), 0);

	/* 5. Event get mask test */
	nx_post(&event, 0xff, NX_POST_SET);             /* 5.1 */
	NXEVENT_TEST(k_event_test(&event, ~0U), 0xff);
	k_event_clear(&event, 0xf);                     /* 5.2 */
	NXEVENT_TEST(k_event_test(&event, ~0U), 0xf0);
	k_event_clear(&event, 0xf0);                    /* 5.3 */
	NXEVENT_TEST(k_event_test(&event, ~0U), 0);

	zassert_equal(nx_error_line, 0, "first failure at line %d (-1: a thread hung)",
		      nx_error_line);
}
```

## src/port.h
```c
/*
 * SPDX-License-Identifier: Apache-2.0
 */

#ifndef PORT_H_
#define PORT_H_

/* The ztest thread is cooperative by default. The ported tests assume a
 * preemptible main thread that a higher priority thread preempts as soon
 * as it is woken, so each test first moves to this priority.
 */
#define PORT_MAIN_PRIO K_PRIO_PREEMPT(10)

#endif /* PORT_H_ */
```

## src/riot_thread_flags.c
```c
/*
 * SPDX-License-Identifier: Apache-2.0
 *
 * Ports of RIOT tests/core/thread_flags and tests/core/thread_flags_group.
 *
 * RIOT thread flags belong to a thread; here each thread gets a k_event:
 * - thread_flags_set(t, f)       k_event_post(&flags_of(t), f)
 * - thread_flags_wait_any(m)     k_event_wait_safe(m): clears what it returns
 * - thread_flags_wait_all(m)     k_event_wait_all_safe(m)
 * - thread_flags_wait_one(m)     no counterpart: wait for any without
 *                                clearing, then clear and return the lowest
 * - xtimer_set_timeout_flag()    a one-shot k_timer posting THREAD_FLAG_TIMEOUT
 * - a thread flags group         one k_event that the members wait on
 * The test scripts (tests/01-run.py) check the order of the printed lines;
 * here the lines go to a log that is compared with the expected one.
 */

#include <stdarg.h>
#include <zephyr/ztest.h>
#include "port.h"

#define THREAD_FLAG_TIMEOUT BIT(14)
#define STACK_SIZE          (1024 + CONFIG_TEST_EXTRA_STACK_SIZE)
#define TIMEOUT_US          (100U * USEC_PER_MSEC)
#define THRESHOLD_US        500U

static K_THREAD_STACK_ARRAY_DEFINE(stacks, 3, STACK_SIZE);
static struct k_thread threads[3];

/* tests/core/thread_flags */

static struct k_event second_flags, main_flags;
static volatile bool done;
static char seq[512];
static size_t seq_len;

static void seq_add(const char *fmt, ...)
{
	va_list ap;

	va_start(ap, fmt);
	seq_len += vsnprintk(&seq[seq_len], sizeof(seq) - seq_len, fmt, ap);
	va_end(ap);
}

static uint32_t wait_one(struct k_event *flags, uint32_t mask)
{
	uint32_t f = k_event_wait(flags, mask, false, K_FOREVER);
	uint32_t one = f & -f;

	k_event_clear(flags, one);
	return one;
}

static void second_thread(void *p1, void *p2, void *p3)
{
	uint32_t f;

	seq_add("w1;");
	f = k_event_wait_safe(&second_flags, 0x1, false, K_FOREVER);
	seq_add("r%x;", f);
	seq_add("w1|64;");
	f = k_event_wait_safe(&second_flags, 0x1 | 0x64, false, K_FOREVER);
	seq_add("r%x;", f);
	seq_add("w2&4;");
	f = k_event_wait_all_safe(&second_flags, 0x2 | 0x4, false, K_FOREVER);
	seq_add("r%x;", f);
	seq_add("w1by1;");
	f = wait_one(&second_flags, 0xFFFF);
	seq_add("r%x;", f);
	seq_add("w1by1;");
	f = wait_one(&second_flags, 0xFFFF);
	seq_add("r%x;", f);
	done = true;
}

static void set(struct k_event *flags, uint32_t f)
{
	seq_add("s%x;", f);
	k_event_post(flags, f);
}

static void timeout_expiry(struct k_timer *timer)
{
	k_event_post(&main_flags, THREAD_FLAG_TIMEOUT);
}

static K_TIMER_DEFINE(timeout_timer, timeout_expiry, NULL);

ZTEST(other_os_events, test_riot_thread_flags)
{
	static const char expected[] =
		"w1;s1;r1;w1|64;s64;r64;w2&4;s1;s8;s2;s4;r6;w1by1;r1;w1by1;r8;";
	int main_prio = PORT_MAIN_PRIO;

	k_thread_priority_set(k_current_get(), main_prio);
	k_event_init(&second_flags);
	k_event_init(&main_flags);
	done = false;
	seq_len = 0;

	k_thread_create(&threads[0], stacks[0], STACK_SIZE, second_thread, NULL, NULL, NULL,
			main_prio - 1, 0, K_NO_WAIT);
	set(&second_flags, 0x1);
	set(&second_flags, 0x64);
	set(&second_flags, 0x1);
	set(&second_flags, 0x8);
	set(&second_flags, 0x2);
	set(&second_flags, 0x4);
	zassert_true(done, "second thread not done (log %s)", seq);
	zassert_mem_equal(seq, expected, sizeof(expected) - 1, "log %s", seq);

	/* The 32-bit and 64-bit xtimer variants are the same here */
	for (int i = 0; i < 2; i++) {
		k_event_clear(&main_flags, ~0U);
		uint64_t before = k_ticks_to_us_floor64(k_uptime_ticks());

		k_timer_start(&timeout_timer, K_USEC(TIMEOUT_US), K_NO_WAIT);
		k_event_wait_safe(&main_flags, THREAD_FLAG_TIMEOUT, false, K_FOREVER);
		uint64_t diff = k_ticks_to_us_floor64(k_uptime_ticks()) - before;

		printk("timeout triggered after %llu us\n", diff);
		zassert_true(diff >= TIMEOUT_US, "timeout after %llu us", diff);
		zassert_true(diff < TIMEOUT_US + THRESHOLD_US, "timeout after %llu us", diff);
	}
}

/* tests/core/thread_flags_group */

#define WAITER_THREADS_CNT 3
#define GOOD_FLAG          0x2
#define BAD_FLAG           0x4

static struct k_event group, forever_flags;
static atomic_t woken_up;
static atomic_t last_prio;
static volatile int order_error;

static void forever_waiter(void *p1, void *p2, void *p3)
{
	/* Not in the group: its own flags never get set */
	k_event_wait_safe(&forever_flags, GOOD_FLAG | BAD_FLAG, false, K_FOREVER);
	order_error = 1;
}

static void waiter(void *p1, void *p2, void *p3)
{
	int prio = k_thread_priority_get(k_current_get());

	k_event_wait(&group, GOOD_FLAG, false, K_FOREVER);
	/* Woken in priority order: highest (lowest number) first */
	if (atomic_get(&last_prio) > prio) {
		order_error = 2;
	}
	atomic_set(&last_prio, prio);
	atomic_inc(&woken_up);
}

ZTEST(other_os_events, test_riot_thread_flags_group)
{
	int main_prio = PORT_MAIN_PRIO;
	unsigned int waiters_cnt = 0;

	k_thread_priority_set(k_current_get(), main_prio);

	k_event_init(&group);
	k_event_init(&forever_flags);
	atomic_set(&woken_up, 0);
	atomic_set(&last_prio, K_HIGHEST_THREAD_PRIO);
	order_error = 0;

	for (int i = 0; i < WAITER_THREADS_CNT; i++) {
		bool is_waiter = (i % 3) != 0;

		if (is_waiter) {
			waiters_cnt++;
		}
		k_thread_create(&threads[i], stacks[i], STACK_SIZE,
				is_waiter ? waiter : forever_waiter, NULL, NULL, NULL,
				main_prio - i - 1, 0, K_NO_WAIT);
	}

	/* This shouldn't wake up */
	k_event_post(&group, BAD_FLAG);
	zassert_equal(atomic_get(&woken_up), 0);

	k_event_post(&group, GOOD_FLAG);
	/* The waiters have higher priorities, so they must have finished */
	zassert_equal(atomic_get(&woken_up), waiters_cnt, "%ld of %u woken",
		      atomic_get(&woken_up), waiters_cnt);
	zassert_equal(order_error, 0, "order error %d", order_error);

	for (int i = 0; i < WAITER_THREADS_CNT; i++) {
		k_thread_abort(&threads[i]);
	}
}
```

## src/rtthread_event.c
```c
/*
 * SPDX-License-Identifier: Apache-2.0
 *
 * Port of RT-Thread src/utest/event_tc.c, test_static_event_send_recv:
 * a receiver takes flag 3 with OR | CLEAR, sleeps while the sender posts
 * flag 5 and flag 3 again, then takes both with AND | CLEAR.
 *
 * RT-Thread -> Zephyr:
 * - rt_event_recv(OR | CLEAR)   k_event_wait_safe()
 * - rt_event_recv(AND | CLEAR)  k_event_wait_all_safe()
 * - rt_event_send()             k_event_post()
 * rt_event_recv() returns the matched flags, as k_event_wait*() does.
 * The init/detach/create/delete cases have no Zephyr counterpart beyond
 * k_event_init() (covered by tests/kernel/events) and are left out; the
 * dynamic variant is the same test on a heap-allocated event.
 */

#include <zephyr/ztest.h>
#include "port.h"

#define EVENT_FLAG3     BIT(3)
#define EVENT_FLAG5     BIT(5)
#define THREAD_PRIORITY 9
#define STACK_SIZE      (1024 + CONFIG_TEST_EXTRA_STACK_SIZE)

static struct k_event static_event;
static K_THREAD_STACK_DEFINE(thread1_stack, STACK_SIZE);
static K_THREAD_STACK_DEFINE(thread2_stack, STACK_SIZE);
static struct k_thread thread1, thread2;
static volatile uint32_t recv_event_times1, recv_event_times2;
static volatile bool recv_finish, send_finish;

static void thread1_recv_static_event(void *p1, void *p2, void *p3)
{
	uint32_t e;

	e = k_event_wait_safe(&static_event, EVENT_FLAG3 | EVENT_FLAG5, false, K_FOREVER);
	if (e == 0) {
		return;
	}
	recv_event_times1 = e;

	k_msleep(50);

	e = k_event_wait_all_safe(&static_event, EVENT_FLAG3 | EVENT_FLAG5, false, K_FOREVER);
	if (e == 0) {
		return;
	}
	recv_event_times2 = e;

	recv_finish = true;
}

static void thread2_send_static_event(void *p1, void *p2, void *p3)
{
	k_event_post(&static_event, EVENT_FLAG3);
	k_msleep(10);

	k_event_post(&static_event, EVENT_FLAG5);
	k_msleep(10);

	k_event_post(&static_event, EVENT_FLAG3);

	send_finish = true;
}

ZTEST(other_os_events, test_rtthread_event_send_recv)
{
	k_thread_priority_set(k_current_get(), PORT_MAIN_PRIO);
	k_event_init(&static_event);
	recv_event_times1 = 0;
	recv_event_times2 = 0;
	recv_finish = false;
	send_finish = false;

	k_thread_create(&thread1, thread1_stack, STACK_SIZE, thread1_recv_static_event,
			NULL, NULL, NULL, K_PRIO_PREEMPT(THREAD_PRIORITY - 1), 0, K_NO_WAIT);
	k_thread_create(&thread2, thread2_stack, STACK_SIZE, thread2_send_static_event,
			NULL, NULL, NULL, K_PRIO_PREEMPT(THREAD_PRIORITY), 0, K_NO_WAIT);

	/* The utest polls with rt_thread_delay(1); bound it here */
	for (int i = 0; i < 1000 && !(recv_finish && send_finish); i++) {
		k_sleep(K_TICKS(1));
	}

	k_thread_abort(&thread1);
	k_thread_abort(&thread2);

	zassert_true(recv_finish && send_finish, "threads did not finish");
	zassert_equal(recv_event_times1, EVENT_FLAG3, "first recv 0x%x", recv_event_times1);
	zassert_equal(recv_event_times2, EVENT_FLAG3 | EVENT_FLAG5, "second recv 0x%x",
		      recv_event_times2);
}
```
